## Kconfig.rednodelabs
```kconfig
# Copyright (c) 2020 RedNodeLabs

rsource "drivers/Kconfig"

config HAS_REDNODELABS_DRIVERS
	bool
	default y if HAS_HW_NRF_RADIO_IEEE802154
```

## boards/arm/fanstel_bt840/Kconfig
```kconfig
# Fanstel BT840 board configuration

# Copyright (c) 2024 RedNodeLabs.
# SPDX-License-Identifier: Apache-2.0

config BOARD_ENABLE_DCDC
	bool "DCDC mode"
	select SOC_DCDC_NRF52X
	default y
	depends on BOARD_FANSTEL_BT840
```

## boards/arm/fanstel_bt840/Kconfig.board
```kconfig
# Fanstel BT840 board configuration

# Copyright (c) 2024 RedNodeLabs.
# SPDX-License-Identifier: Apache-2.0

config BOARD_FANSTEL_BT840
	bool "Fanstel BT840"
	depends on SOC_NRF52840_QIAA
```

## boards/arm/fanstel_bt840/Kconfig.defconfig
```kconfig
# Fanstel BT840 board configuration

# Copyright (c) 2024 RedNodeLabs.
# SPDX-License-Identifier: Apache-2.0

if BOARD_FANSTEL_BT840

config BOARD
	default "fanstel_bt840"

config BT_CTLR
	default BT

endif # BOARD_FANSTEL_BT840
```

## boards/arm/fanstel_bu840xe/Kconfig.board
```kconfig
# Fanstel BU840XE board configuration

# Copyright (c) 4 RedNodeLabs.
# SPDX-License-Identifier: Apache-2.0

config BOARD_FANSTEL_BU840XE
	bool "Fanstel BU840XE"
	depends on SOC_NRF52840_QIAA
```

## boards/arm/fanstel_bu840xe/Kconfig.defconfig
```kconfig
# Fanstel BU840XE board configuration

# Copyright (c) 2024 RedNodeLabs.
# SPDX-License-Identifier: Apache-2.0

if BOARD_FANSTEL_BU840XE

config BOARD
	default "fanstel_bu840xe"

config BT_CTLR
	default BT

config I2C
	default SENSOR

config SPI
	default y
	depends on IEEE802154

endif # BOARD_FANSTEL_BU840XE
```

## boards/arm/insightsip_isp3010_dev/Kconfig
```kconfig
# Insightsip ISP3010 DEV board configuration

# Copyright (c) 2021 RedNodeLabs.
# SPDX-License-Identifier: Apache-2.0

config BOARD_ENABLE_DCDC
	bool "Enable DCDC mode"
	select SOC_DCDC_NRF52X
	default y
	depends on BOARD_INSIGHTSIP_ISP3010_DEV
```

## boards/arm/insightsip_isp3010_dev/Kconfig.board
```kconfig
# Insightsip ISP3010 DEV board configuration

# Copyright (c) 2021 RedNodeLabs.
# SPDX-License-Identifier: Apache-2.0

config BOARD_INSIGHTSIP_ISP3010_DEV
	bool "Insightsip ISP3010-DEV"
	depends on SOC_NRF52832_QFAA
```

## boards/arm/insightsip_isp3010_dev/Kconfig.defconfig
```kconfig
# Insightsip ISP3010 DEV board configuration

# Copyright (c) 2022 RedNodeLabs.
# SPDX-License-Identifier: Apache-2.0

if BOARD_INSIGHTSIP_ISP3010_DEV

config BOARD
	default "insightsip_isp3010_dev"

config BT_CTLR
	default BT

config I2C
	default SENSOR

config SPI
	default y
	depends on IEEE802154

config IEEE802154_DW1000
	default y
	depends on IEEE802154

endif # BOARD_INSIGHTSIP_ISP3010_DEV
```

## boards/arm/nrf52840april_nrf52840/Kconfig.board
```kconfig
# nRF52840 April NRF52840 board configuration

# Copyright (c) 2022 RedNodeLabs.
# SPDX-License-Identifier: Apache-2.0

config BOARD_NRF52840APRIL_NRF52840
	bool "nRF52840 APRIL NRF52840"
	depends on SOC_NRF52840_QIAA
```

## boards/arm/nrf52840dongle_nrf52840_april/Kconfig
```kconfig
# nRF52840 Dongle NRF52840 April board configuration

# Copyright (c) 2021 RedNodeLabs.
# SPDX-License-Identifier: Apache-2.0

if BOARD_NRF52840DONGLE_NRF52840_APRIL

config BOARD_ENABLE_DCDC
	bool "Enable DCDC mode"
	select SOC_DCDC_NRF52X
	default y

config BOARD_HAS_ADAFRUIT_BOOTLOADER
	bool "Board has Adafruit bootloader"
	default y
	help
	  If selected, applications are linked so that they can be loaded by
	  Adafruit bootloader.

endif # BOARD_NRF52840DONGLE_NRF52840
```

## boards/arm/nrf52840dongle_nrf52840_april/Kconfig.board
```kconfig
# nRF52840 Dongle NRF52840 April board configuration

# Copyright (c) 2021 RedNodeLabs.
# SPDX-License-Identifier: Apache-2.0

config BOARD_NRF52840DONGLE_NRF52840_APRIL
	bool "nRF52840 DONGLE NRF52840 APRIL"
	depends on SOC_NRF52840_QIAA
```

## boards/arm/qorvo_dwm3001c_dev/Kconfig.board
```kconfig
# Qorvo DWM3001C board configuration

# Copyright (c) 2022 RedNodeLabs.
# SPDX-License-Identifier: Apache-2.0

config BOARD_QORVO_DWM3001C_DEV
	bool "Qorvo DWM3001C-DEV"
	depends on SOC_NRF52833_QIAA
```

## boards/arm/qorvo_dwm3001c_dev/Kconfig.defconfig
```kconfig
# Qorvo DWM3001C board configuration

# Copyright (c) 2022 RedNodeLabs.
# SPDX-License-Identifier: Apache-2.0

if BOARD_QORVO_DWM3001C_DEV

config BOARD
	default "qorvo_dwm3001c_dev"

config BT_CTLR
	default BT

config I2C
	default SENSOR

config SPI
	default y
	depends on IEEE802154

config IEEE802154_DW3000
	bool "Enables DW3000 board"
	default y
	depends on IEEE802154

endif # BOARD_QORVO_DWM3001C_DEV
```

## boards/arm/rnl_w1/Kconfig
```kconfig
# RedNodeLabs W1 board configuration

# Copyright (c) 2023 RedNodeLabs.
# SPDX-License-Identifier: Apache-2.0

config BOARD_ENABLE_DCDC
	bool "DCDC mode"
	select SOC_DCDC_NRF52X
	default y
	depends on BOARD_RNL_W1
```

## boards/arm/rnl_w1/Kconfig.board
```kconfig
# RedNodeLabs W1 board configuration

# Copyright (c) 2023 RedNodeLabs.
# SPDX-License-Identifier: Apache-2.0

config BOARD_RNL_W1
	bool "RedNodeLabs W1"
	depends on SOC_NRF52833_QIAA
```

## boards/arm/rnl_w1/Kconfig.defconfig
```kconfig
# RedNodeLabs W1 board configuration

# Copyright (c) 2023 RedNodeLabs.
# SPDX-License-Identifier: Apache-2.0

if BOARD_RNL_W1

config BOARD
	default "rnl_w1"

config BT_CTLR
	default BT

config I2C
	default SENSOR

config SPI
	default y
	depends on IEEE802154

config IEEE802154_DW3000
	bool "Enables DW3000 board"
	default y
	depends on IEEE802154

endif # BOARD_RNL_W1
```

## boards/arm/rnl_w1/rnl_w1_defconfig
```kconfig
# SPDX-License-Identifier: Apache-2.0

CONFIG_SOC_SERIES_NRF52X=y
CONFIG_SOC_NRF52833_QIAA=y
CONFIG_BOARD_RNL_W1=y

# Enable MPU
CONFIG_ARM_MPU=y

# Enable hardware stack protection
CONFIG_HW_STACK_PROTECTION=y

# enable GPIO
CONFIG_GPIO=y

# enable serial driver
CONFIG_SERIAL=y

# additional board options
CONFIG_GPIO_AS_PINRESET=y

CONFIG_PINCTRL=y
```

## boards/arm/rnl_w1x/Kconfig.board
```kconfig
# RedNodeLabs W1X board configuration

# Copyright (c) 2023 RedNodeLabs.
# SPDX-License-Identifier: Apache-2.0

config BOARD_RNL_W1X
	bool "RedNodeLabs W1X"
	depends on SOC_NRF52833_QIAA
```

## boards/arm/rnl_w1x/Kconfig.defconfig
```kconfig
# RedNodeLabs W1X board configuration

# Copyright (c) 2023 RedNodeLabs.
# SPDX-License-Identifier: Apache-2.0

if BOARD_RNL_W1X

config BOARD
	default "rnl_w1x"

config BT_CTLR
	default BT

config I2C
	default SENSOR

config SPI
	default y
	depends on IEEE802154

endif # BOARD_RNL_W1X
```

## west.yml
```yaml
manifest:
  version: '0.12'
  remotes:
  - name: rnl
    url-base: https://github.com/rednodelabs
  - name: ncs
    url-base: https://github.com/nrfconnect
  defaults:
    remote: rnl
  projects:
  - name: nrf
    repo-path: sdk-nrf
    revision: v2.1.0
    remote: ncs
    import:
      name-blocklist:
      - zephyr
      - openthread
  - name: zephyr
    revision: rednodelabs/v1.0.1
    import:
      name-allowlist:
      - TraceRecorderSource
      - canopennode
      - chre
      - cmsis
      - edtt
      - fatfs
      - fff
      - hal_nordic
      - hal_st
      - liblc3codec
      - libmetal
      - littlefs
      - loramac-node
      - lvgl
      - lz4
      - mbedtls
      - mipi-sys-t
      - nanopb
      - net-tools
      - nrf_hw_models
      - open-amp
      - picolibc
      - psa-arch-tests
      - segger
      - tinycbor
      - tinycrypt
      - tf-m-tests
      - zcbor
      - zscilib
  - name: openthread
    path: modules/lib/openthread
    revision: rednodelabs/v1.0.5
  - name: rednodebus-release
    revision: v1.0.10
  self:
    west-commands: nrf/scripts/west-commands.yml
```
