## CMakeLists.txt
```
# SPDX-License-Identifier: Apache-2.0

cmake_minimum_required(VERSION 3.20.0)

list(APPEND DTS_ROOT ${CMAKE_CURRENT_SOURCE_DIR}/../..)
list(APPEND BOARD_ROOT ${CMAKE_CURRENT_SOURCE_DIR}/../..)

string(REPLACE " " ";" OVERLAY_CONFIG_LIST "${OVERLAY_CONFIG}")
if("overlay-ot-rnb.conf" IN_LIST OVERLAY_CONFIG_LIST)
  include(${CMAKE_CURRENT_SOURCE_DIR}/../common/CMakeLists.txt)
endif()

find_package(Zephyr REQUIRED HINTS $ENV{ZEPHYR_BASE})

project(accelerometer)

target_sources(app PRIVATE src/accelerometer.c)

target_include_directories(app PUBLIC ${CMAKE_CURRENT_SOURCE_DIR}/../../include)

target_sources_ifndef(CONFIG_USE_REDNODEBUS_USER_PAYLOAD app PRIVATE src/udp.c)
target_sources_ifdef(CONFIG_USE_REDNODEBUS_USER_PAYLOAD app PRIVATE src/rnb-user-payload.c)

target_include_directories_ifdef(CONFIG_REDNODEBUS app PUBLIC ../common/src)
target_sources_ifdef(CONFIG_REDNODEBUS app PRIVATE
  ${CMAKE_CURRENT_SOURCE_DIR}/../common/src/rnb_utils.c
  ${CMAKE_CURRENT_SOURCE_DIR}/../common/src/rnb_leds.c
  ${CMAKE_CURRENT_SOURCE_DIR}/../common/src/rnb_pa_lna.c)
target_sources_ifdef(CONFIG_REDNODERANGING app PRIVATE
  ${CMAKE_CURRENT_SOURCE_DIR}/../common/src/rnb_ranging_port.c
  ${CMAKE_CURRENT_SOURCE_DIR}/../common/src/rnb_ranging_spi.c
  ${CMAKE_CURRENT_SOURCE_DIR}/../common/src/rnb_ranging_sleep.c)

include(${ZEPHYR_BASE}/samples/net/common/common.cmake)
```

## Kconfig
```
# Copyright (c) 2025 RedNodeLabs
# SPDX-License-Identifier: Apache-2.0

menu "accelerometer"

config USE_REDNODEBUS_USER_PAYLOAD
	bool "Enable data traffic through RedNodeBus user payload mechanism"
	default n

source "Kconfig.zephyr"

endmenu
```

## sample.yaml
```
sample:
  name: Accelerometer
  description: Test sending acceleration values using the UDP client
tests:
  sample.accelerometer.rnb:
    platform_allow: decawave_dwm1001_dev qorvo_dwm3001c_dev rnl_w1
    integration_platforms:
      - decawave_dwm1001_dev
      - qorvo_dwm3001c_dev
      - rnl_w1
    extra_args: OVERLAY_CONFIG=overlay-ot-rnb.conf
    build_only: true
    tags: ci_build
  sample.accelerometer.rnb.rnb_user_payload:
    platform_allow: decawave_dwm1001_dev qorvo_dwm3001c_dev rnl_w1
    integration_platforms:
      - decawave_dwm1001_dev
      - qorvo_dwm3001c_dev
      - rnl_w1
    extra_args: OVERLAY_CONFIG=overlay-ot-rnb.conf;overlay-rnb-user-payload.conf
    build_only: true
    tags: ci_build
```

## prj.conf
```kconfig
# Copyright (c) 2024 RedNodeLabs.

# Generic networking options
CONFIG_NETWORKING=y
CONFIG_NET_UDP=y
CONFIG_NET_TCP=y
CONFIG_NET_IPV6=y
CONFIG_NET_IPV4=y
CONFIG_NET_SOCKETS=y
CONFIG_NET_SOCKETS_POSIX_NAMES=y
CONFIG_NET_SOCKETS_POLL_MAX=4
CONFIG_NET_CONNECTION_MANAGER=y

# Kernel options
CONFIG_ENTROPY_GENERATOR=y
CONFIG_TEST_RANDOM_GENERATOR=y
CONFIG_INIT_STACKS=y

# Logging
CONFIG_NET_LOG=y
CONFIG_LOG=y
CONFIG_NET_STATISTICS=n
CONFIG_PRINTK=y

# Network buffers
CONFIG_NET_PKT_RX_COUNT=16
CONFIG_NET_PKT_TX_COUNT=16
CONFIG_NET_BUF_RX_COUNT=80
CONFIG_NET_BUF_TX_COUNT=80
CONFIG_NET_CONTEXT_NET_PKT_POOL=n

# IP address options
CONFIG_NET_IF_UNICAST_IPV6_ADDR_COUNT=6
CONFIG_NET_IF_MCAST_IPV6_ADDR_COUNT=8
CONFIG_NET_MAX_CONTEXTS=10

# Network shell
CONFIG_NET_SHELL=y

# The addresses are selected so that qemu<->qemu connectivity works ok.
# For linux<->qemu connectivity, create a new conf file and swap the
# addresses (so that peer address is ending to 2).
CONFIG_NET_CONFIG_SETTINGS=n
CONFIG_NET_CONFIG_NEED_IPV6=y
#CONFIG_NET_CONFIG_MY_IPV6_ADDR="2001:db8::2"
#CONFIG_NET_CONFIG_PEER_IPV6_ADDR="2001:0db8:0001:ffff:0000:0000:ac11:0001"
CONFIG_NET_CONFIG_NEED_IPV4=y
#CONFIG_NET_CONFIG_MY_IPV4_ADDR="192.0.2.2"
#CONFIG_NET_CONFIG_PEER_IPV4_ADDR="192.0.2.1"

# Accelerometer options
CONFIG_I2C=y
CONFIG_SENSOR=y
CONFIG_LIS2DH=y
CONFIG_LIS2DH_TRIGGER_GLOBAL_THREAD=y
CONFIG_LIS2DH_ODR_1=y
CONFIG_LIS2DH_OPER_MODE_HIGH_RES=y
```

## overlay-ot-rnb.conf
```kconfig
#
# Copyright (c) 2022 RedNodeLabs
#

CONFIG_NEWLIB_LIBC=y

# Disable TCP and IPv4 (TCP disabled to avoid heavy traffic)
CONFIG_NET_TCP=n
CONFIG_NET_IPV4=n

CONFIG_NET_IPV6_NBR_CACHE=n
CONFIG_NET_IPV6_MLD=n
CONFIG_NET_CONFIG_NEED_IPV4=n
CONFIG_NET_CONFIG_MY_IPV4_ADDR=""
CONFIG_NET_CONFIG_PEER_IPV4_ADDR=""

CONFIG_SYSTEM_WORKQUEUE_STACK_SIZE=2048
CONFIG_SYSTEM_WORKQUEUE_PRIORITY=1
CONFIG_MAIN_STACK_SIZE=2048

CONFIG_NET_L2_OPENTHREAD=y

CONFIG_OPENTHREAD_DEBUG=y
CONFIG_OPENTHREAD_L2_DEBUG=y
CONFIG_OPENTHREAD_L2_LOG_LEVEL_INF=y

# A sample configuration to enable Thread Joiner, uncomment if needed
#CONFIG_OPENTHREAD_JOINER=y
#CONFIG_OPENTHREAD_JOINER_AUTOSTART=y

# Enable diagnostic module, uncomment if needed
#CONFIG_OPENTHREAD_DIAG=y

CONFIG_SHELL=n
CONFIG_NET_SHELL=n
CONFIG_NET_MGMT=n
CONFIG_NET_STATISTICS=n
CONFIG_CONSOLE=n
CONFIG_SERIAL=n
CONFIG_USE_SEGGER_RTT=n
CONFIG_FLASH_SHELL=n
CONFIG_OPENTHREAD_MTD=y
CONFIG_OPENTHREAD_SLAAC=y

# Network buffers
CONFIG_OPENTHREAD_NUM_MESSAGE_BUFFERS=32
CONFIG_NET_PKT_RX_COUNT=4
CONFIG_NET_PKT_TX_COUNT=4
CONFIG_NET_BUF_RX_COUNT=16
CONFIG_NET_BUF_TX_COUNT=16
```

## overlay-rnb-user-payload.conf
```kconfig
#
# Copyright (c) 2025 RedNodeLabs
#

CONFIG_USE_REDNODEBUS_USER_PAYLOAD=y
```

## boards/decawave_dwm1001_dev.conf
```kconfig
CONFIG_OPENTHREAD_JOINER=n

CONFIG_OPENTHREAD_PANID=38339
CONFIG_OPENTHREAD_NETWORK_NAME="RedNodeLabs"
CONFIG_OPENTHREAD_XPANID="0xdead00beef00cafe"
CONFIG_OPENTHREAD_NETWORKKEY="dc:a6:fd:86:7d:f1:16:1b:d8:b7:f4:90:f6:49:25:eb"

CONFIG_MBEDTLS_HEAP_SIZE=2800
```

## src/accelerometer.c
```c
/* socket-test.c - Networking accelerometer UDP socket client */

/*
 * Copyright (c) 2022 RedNodeLabs UG.
 *
 * SPDX-License-Identifier: Apache-2.0
 */

/*
 * The accelerometer application is acting as a client that is run in Zephyr OS,
 * and the server is run in the host acting as a server.
 */

#include <logging/log.h>
LOG_MODULE_REGISTER(net_accelerometer_sample, LOG_LEVEL_DBG);

#include <zephyr.h>
#include <errno.h>
#include <stdio.h>

#include <syscalls/rand32.h>
#include <net/socket.h>
#include <net/net_mgmt.h>
#include <net/net_event.h>
#include <net/net_conn_mgr.h>
#include <net/ieee802154_radio.h>

#include <device.h>
#include <drivers/sensor.h>

#if defined(CONFIG_REDNODEBUS)
#include "rnb_utils.h"
#endif

#include "common.h"

#define INVALID_SOCK (-1)

#define EVENT_MASK (NET_EVENT_L4_CONNECTED | \
		    NET_EVENT_L4_DISCONNECTED)

#define MTU_SIZE 1280

static uint8_t rnb_role;

void rnb_utils_handle_new_state(const struct rednodebus_user_event_params_state *state)
{
	rnb_role = state->role;
}

int32_t packet_buffer[10];
const int packet_len = sizeof(packet_buffer);

const struct device *sensor;

#if defined(CONFIG_USE_REDNODEBUS_USER_PAYLOAD)
struct configs_rnb conf_rnb = {
	.rnb = {
		.proto = "RNB",
		.rnb_user_payload.mtu = REDNODEBUS_USER_PAYLOAD_MAX_LENGTH
	}
};
#else
struct configs conf = {
    	.ipv6 = {
		.proto = "IPv6",
		.udp.sock = INVALID_SOCK
	}
};
#endif

static void init_app(void)
{
#if defined(CONFIG_USE_REDNODEBUS_USER_PAYLOAD)

#else
	conf.ipv6.udp.mtu = MTU_SIZE;
#endif

#if defined(CONFIG_REDNODEBUS)
	uint64_t euid = 0;
	rnb_utils_get_euid(&euid);

	packet_buffer[0] = (uint32_t)euid;
	packet_buffer[1] = (uint32_t)(euid >> 32);

	int session_rand = sys_rand32_get();
	packet_buffer[2] = session_rand;
#endif
}

static void fetch_and_display(const struct device *sensor)
{
	static unsigned int count;
	static unsigned int packets_sent;
	struct sensor_value accel[3];
	const char *overrun = "";
	int rc = sensor_sample_fetch(sensor);

	++count;
	if (rc == -EBADMSG)
	{
		overrun = "[OVERRUN] ";
		rc = 0;
	}
	if (rc == 0)
	{
		rc = sensor_channel_get(sensor,
					SENSOR_CHAN_ACCEL_XYZ,
					accel);
	}

	if (rc < 0)
	{
		LOG_INF("ERROR: Accelerometer data failed: %d\n", rc);
	}
	else
	{
		packet_buffer[3] = packets_sent;
		packet_buffer[4] = accel[0].val1;
		packet_buffer[5] = accel[0].val2;
		packet_buffer[6] = accel[1].val1;
		packet_buffer[7] = accel[1].val2;
		packet_buffer[8] = accel[2].val1;
		packet_buffer[9] = accel[2].val2;

#if defined(CONFIG_USE_REDNODEBUS_USER_PAYLOAD)
		conf_rnb.rnb.rnb_user_payload.transmitting = packet_len;
		memcpy(&conf_rnb.rnb.rnb_user_payload.rnb_user_payload_params.user_payload, packet_buffer, conf_rnb.rnb.rnb_user_payload.transmitting);
		rc = send_rnb_data(&conf_rnb.rnb);
#else
		rc = send_udp_data(&conf.ipv6);
#endif

		if(rc == 0)
		{
			packets_sent++;
		}

		LOG_DBG("#%u EUID 0x%04X%04X @ %u ms; %sx_acc: %d, y_acc: %0d, z_acc: %d\n",
			count, packet_buffer[1], packet_buffer[0], k_uptime_get_32(), overrun,
			packet_buffer[4], packet_buffer[6], packet_buffer[8]);
	}
}

static void trigger_handler(const struct device *dev,
			    const struct sensor_trigger *trig)
{
	fetch_and_display(dev);
}

static void accelerometer()
{
	sensor = DEVICE_DT_GET_ANY(st_lis2dh);

	if (sensor == NULL)
	{
		LOG_ERR("Accelerometer not found\n");
		return;
	}
	if (!device_is_ready(sensor))
	{
		LOG_ERR("Device %s is not ready\n", sensor->name);
		return;
	}

	struct sensor_trigger trig;
	int rc;

	trig.type = SENSOR_TRIG_DATA_READY;
	trig.chan = SENSOR_CHAN_ACCEL_XYZ;

	rc = sensor_trigger_set(sensor, &trig, trigger_handler);
	if (rc != 0)
	{
		LOG_ERR("Failed to set trigger: %d\n", rc);
		return;
	}
}

static void start_client(void)
{
	int ret;

	if (rnb_role == REDNODEBUS_USER_ROLE_TAG)
	{
#if defined(CONFIG_USE_REDNODEBUS_USER_PAYLOAD)
		ret = start_rnb_user_payload();
#else
		ret = start_udp();
#endif

		if (ret == 0)
		{
			accelerometer();
		}
		else
		{
#if defined(CONFIG_USE_REDNODEBUS_USER_PAYLOAD)
			LOG_ERR("RNB user payload init failed");
			stop_rnb_user_payload();
#else
			LOG_ERR("UDP init failed");
			stop_udp();
#endif
		}
	}
}

void main(void)
{
#if defined(CONFIG_REDNODEBUS)
	init_rnb();

	while (!is_rnb_connected())
	{
		k_sleep(K_MSEC(1000));
	}
#endif

	init_app();

	k_thread_priority_set(k_current_get(), THREAD_PRIORITY);

	start_client();
}
```

## src/common.h
```c
/*
 * Copyright (c) 2017 Intel Corporation.
 * Copyright (c) 2018 Nordic Semiconductor ASA.
 *
 * SPDX-License-Identifier: Apache-2.0
 */

#include <net/ieee802154_radio.h>

/* Value of 0 will cause the IP stack to select next free port */
#define MY_PORT 0

#define PEER_PORT 4242

#if IS_ENABLED(CONFIG_NET_TC_THREAD_PREEMPTIVE)
#define THREAD_PRIORITY K_PRIO_PREEMPT(8)
#else
#define THREAD_PRIORITY K_PRIO_COOP(CONFIG_NUM_COOP_PRIORITIES - 1)
#endif

struct data
{
	const char *proto;

	struct
	{
		int sock;
		uint32_t transmitting;
		uint32_t mtu;
	} udp;
};

struct data_rnb {
	const char *proto;

	struct {
		struct rednodebus_user_payload_params rnb_user_payload_params;
		uint32_t transmitting;
		uint32_t mtu;
	} rnb_user_payload;
};

struct configs
{
	struct data ipv6;
};
struct configs_rnb {
	struct data_rnb rnb;
};

#if !defined(CONFIG_NET_CONFIG_PEER_IPV6_ADDR)
#define CONFIG_NET_CONFIG_PEER_IPV6_ADDR "2001:0db8:0001:ffff:0000:0000:ac11:0001"
#endif

extern int32_t packet_buffer[];
extern const int packet_len;
extern struct configs conf;

int start_udp(void);
void stop_udp(void);
int send_udp_data(struct data *data);

int start_rnb_user_payload(void);
void stop_rnb_user_payload(void);
int send_rnb_data(struct data_rnb *data);
```

## src/rnb-user-payload.c
```c
/* rnb-user-payload.c - RedNodeBus payload */

/*
 * Copyright (c) 2025 RedNodeLabs.
 *
 * SPDX-License-Identifier: Apache-2.0
 */

#include <logging/log.h>
LOG_MODULE_DECLARE(net_accelerometer_sample, LOG_LEVEL_DBG);

#include <zephyr.h>
#include <errno.h>
#include <stdio.h>

#include <net/ieee802154_radio.h>

#include "common.h"

/* Convenience defines for RADIO */
#define REDNODEBUS_API(dev) ((const struct ieee802154_radio_api *const)(dev)->api)

int send_rnb_data(struct data_rnb *data)
{
	const struct device *dev = device_get_binding(CONFIG_IEEE802154_NRF5_DRV_NAME);
	int ret;

	if(data->rnb_user_payload.transmitting == 0 || data->rnb_user_payload.transmitting > data->rnb_user_payload.mtu)
	{
		LOG_ERR("%s USER PAYLOAD: Invalid data size %d", data->proto, data->rnb_user_payload.transmitting);
		ret = -EINVAL;
		goto exit;
	}

	ret = REDNODEBUS_API(dev)->send_rnb_user_payload(dev, &data->rnb_user_payload.rnb_user_payload_params, data->rnb_user_payload.transmitting);

	if (ret == 0)
	{
		LOG_DBG("%s USER PAYLOAD: Sent %d bytes", data->proto, data->rnb_user_payload.transmitting);
		LOG_HEXDUMP_DBG(&data->rnb_user_payload.rnb_user_payload_params.user_payload, data->rnb_user_payload.transmitting, "Data");
	}
	else
	{
		LOG_ERR("%s USER PAYLOAD: error sending %d", data->proto, ret);
	}

exit:
	return ret < 0 ? -EIO : 0;
}

int start_rnb_user_payload(void)
{
	return 0;
}

void stop_rnb_user_payload(void)
{
}
```

## src/udp.c
```c
/* udp.c - UDP specific code for echo client */

/*
 * Copyright (c) 2017 Intel Corporation.
 * Copyright (c) 2018 Nordic Semiconductor ASA.
 *
 * SPDX-License-Identifier: Apache-2.0
 */

#include <logging/log.h>
LOG_MODULE_DECLARE(net_accelerometer_sample, LOG_LEVEL_DBG);

#include <zephyr.h>
#include <errno.h>
#include <stdio.h>

#include <net/socket.h>
#include <net/tls_credentials.h>
#include <random/rand32.h>

#include "common.h"

int send_udp_data(struct data *data)
{
	int ret;

	data->udp.transmitting = packet_len;

	ret = send(data->udp.sock, packet_buffer, data->udp.transmitting, 0);

	LOG_DBG("%s UDP: Sent %d bytes", data->proto, data->udp.transmitting);

	return ret < 0 ? -EIO : 0;
}

static int start_udp_proto(struct data *data, struct sockaddr *addr,
			   socklen_t addrlen)
{
	int ret;

	data->udp.sock = socket(addr->sa_family, SOCK_DGRAM, IPPROTO_UDP);

	if (data->udp.sock < 0)
	{
		LOG_ERR("Failed to create UDP socket (%s): %d", data->proto,
			errno);
		return -errno;
	}

	/* Call connect so we can use send and recv. */
	ret = connect(data->udp.sock, addr, addrlen);
	if (ret < 0)
	{
		LOG_ERR("Cannot connect to UDP remote (%s): %d", data->proto,
			errno);
		ret = -errno;
	}

	return ret;
}

int start_udp(void)
{
	int ret = 0;
	struct sockaddr_in6 addr6;

	if (IS_ENABLED(CONFIG_NET_IPV6))
	{
		addr6.sin6_family = AF_INET6;
		addr6.sin6_port = htons(PEER_PORT);
		inet_pton(AF_INET6, CONFIG_NET_CONFIG_PEER_IPV6_ADDR,
			  &addr6.sin6_addr);

		ret = start_udp_proto(&conf.ipv6, (struct sockaddr *)&addr6,
				      sizeof(addr6));
		if (ret < 0)
		{
			return ret;
		}
	}

	return ret;
}

void stop_udp(void)
{
	if (IS_ENABLED(CONFIG_NET_IPV6))
	{
		if (conf.ipv6.udp.sock >= 0)
		{
			(void)close(conf.ipv6.udp.sock);
		}
	}
}
```
