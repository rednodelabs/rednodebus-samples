## CMakeLists.txt
```
# SPDX-License-Identifier: Apache-2.0

cmake_minimum_required(VERSION 3.20.0)

list(APPEND DTS_ROOT ${CMAKE_CURRENT_SOURCE_DIR}/../..)
list(APPEND BOARD_ROOT ${CMAKE_CURRENT_SOURCE_DIR}/../..)

string(REPLACE " " ";" OVERLAY_CONFIG_LIST "${OVERLAY_CONFIG}")
if("overlay-ot-rnb.conf" IN_LIST OVERLAY_CONFIG_LIST)
  include(${CMAKE_CURRENT_SOURCE_DIR}/../common/CMakeLists.txt)
endif()

find_package(Zephyr REQUIRED HINTS $ENV{ZEPHYR_BASE})

project(rednodebus_node)

target_sources(app PRIVATE src/main.c)

target_include_directories(app PUBLIC ${CMAKE_CURRENT_SOURCE_DIR}/../../include)

target_include_directories_ifdef(CONFIG_REDNODEBUS app PUBLIC
  ${CMAKE_CURRENT_SOURCE_DIR}/../common/src)
target_sources_ifdef(CONFIG_REDNODEBUS app PRIVATE
  ${CMAKE_CURRENT_SOURCE_DIR}/../common/src/rnb_utils.c
  ${CMAKE_CURRENT_SOURCE_DIR}/../common/src/rnb_leds.c
  ${CMAKE_CURRENT_SOURCE_DIR}/../common/src/rnb_pa_lna.c)
target_sources_ifdef(CONFIG_REDNODERANGING app PRIVATE
  ${CMAKE_CURRENT_SOURCE_DIR}/../common/src/rnb_ranging_port.c
  ${CMAKE_CURRENT_SOURCE_DIR}/../common/src/rnb_ranging_spi.c
  ${CMAKE_CURRENT_SOURCE_DIR}/../common/src/rnb_ranging_sleep.c)
```

## sample.yaml
```
sample:
  name: RedNodeBus Node
  description: Test RedNodeBus Node
tests:
  sample.rednodebus_node.rnb:
    platform_allow: nrf52832_mdk nrf52840dk_nrf52840 nrf52833dk_nrf52833 nrf52840dongle_nrf52840 decawave_dwm1001_dev insightsip_isp3010_dev qorvo_dwm3001c_dev rnl_w1 rnl_w1x fanstel_bu840xe
    integration_platforms:
      - nrf52832_mdk
      - nrf52833dk_nrf52833
      - nrf52840dk_nrf52840
      - nrf52840dongle_nrf52840
      - decawave_dwm1001_dev
      - insightsip_isp3010_dev
      - qorvo_dwm3001c_dev
      - rnl_w1
      - rnl_w1x
      - fanstel_bu840xe
    extra_args: OVERLAY_CONFIG=overlay-ot-rnb.conf
    build_only: true
    tags: ci_build
  sample.rednodebus_node.rnb.debug:
    platform_allow: nrf52832_mdk nrf52840dk_nrf52840 nrf52833dk_nrf52833 nrf52840dongle_nrf52840 decawave_dwm1001_dev insightsip_isp3010_dev qorvo_dwm3001c_dev rnl_w1 rnl_w1x fanstel_bu840xe
    integration_platforms:
      - nrf52832_mdk
      - nrf52833dk_nrf52833
      - nrf52840dk_nrf52840
      - decawave_dwm1001_dev
      - qorvo_dwm3001c_dev
    extra_args: OVERLAY_CONFIG=overlay-ot-rnb.conf;overlay-debug.conf
    build_only: true
    tags: ci_private_build
  sample.rednodebus_node.rnb.ranging_diag:
    platform_allow: decawave_dwm1001_dev insightsip_isp3010_dev qorvo_dwm3001c_dev rnl_w1
    integration_platforms:
      - decawave_dwm1001_dev
      - qorvo_dwm3001c_dev
    extra_args: OVERLAY_CONFIG=overlay-ot-rnb.conf;../common/overlay-rnb-ranging-diagnostic.conf
    build_only: true
    tags: ci_build
  sample.rednodebus_node.rnb.usb.mcuboot:
    platform_allow: rnl_w1 rnl_w1x fanstel_bu840xe
    integration_platforms:
      - rnl_w1
      - rnl_w1x
      - fanstel_bu840xe
    extra_args: CONF_FILE=prj_mcuboot.conf
                OVERLAY_CONFIG=overlay-ot-rnb.conf;
    build_only: true
    tags: ci_private_build
```

## prj.conf
```kconfig
# Generic networking options
CONFIG_NETWORKING=y
CONFIG_NET_UDP=y
CONFIG_NET_TCP=y
CONFIG_NET_IPV6=y
CONFIG_NET_IPV4=y
CONFIG_NET_SOCKETS=y
CONFIG_NET_SOCKETS_POSIX_NAMES=y
CONFIG_NET_SOCKETS_POLL_MAX=4
CONFIG_NET_CONNECTION_MANAGER=y

# Kernel options
CONFIG_ENTROPY_GENERATOR=y
CONFIG_TEST_RANDOM_GENERATOR=y
CONFIG_INIT_STACKS=y

# Logging
CONFIG_NET_LOG=y
CONFIG_LOG=y
CONFIG_NET_STATISTICS=n
CONFIG_PRINTK=y

# Network buffers
CONFIG_NET_PKT_RX_COUNT=16
CONFIG_NET_PKT_TX_COUNT=16
CONFIG_NET_BUF_RX_COUNT=80
CONFIG_NET_BUF_TX_COUNT=80
CONFIG_NET_CONTEXT_NET_PKT_POOL=n

# IP address options
CONFIG_NET_IF_UNICAST_IPV6_ADDR_COUNT=6
CONFIG_NET_IF_MCAST_IPV6_ADDR_COUNT=8
CONFIG_NET_MAX_CONTEXTS=10

# Network shell
CONFIG_NET_SHELL=y

# The addresses are selected so that qemu<->qemu connectivity works ok.
# For linux<->qemu connectivity, create a new conf file and swap the
# addresses (so that peer address is ending to 2).
CONFIG_NET_CONFIG_SETTINGS=n
CONFIG_NET_CONFIG_NEED_IPV6=y
#CONFIG_NET_CONFIG_MY_IPV6_ADDR="2001:db8::2"
#CONFIG_NET_CONFIG_PEER_IPV6_ADDR="2001:0db8:0001:ffff:0000:0000:ac11:0001"
CONFIG_NET_CONFIG_NEED_IPV4=y
#CONFIG_NET_CONFIG_MY_IPV4_ADDR="192.0.2.2"
#CONFIG_NET_CONFIG_PEER_IPV4_ADDR="192.0.2.1"
```

## overlay-debug.conf
```kconfig
#
# Copyright (c) 2022 RedNodeLabs
#

CONFIG_USE_SEGGER_RTT=y
CONFIG_LOG_BACKEND_RTT=y

CONFIG_LOG=y
CONFIG_NET_LOG=y
CONFIG_SHELL=n
CONFIG_OPENTHREAD_SHELL=n
CONFIG_SHELL_BACKEND_SERIAL=n
CONFIG_SHELL_LOG_BACKEND=n
CONFIG_NET_SHELL=n
CONFIG_THREAD_NAME=y
CONFIG_ASSERT=y
CONFIG_WATCHDOG=n

CONFIG_REDNODEBUS_DRIVER_LOG_LEVEL_WRN=y
CONFIG_REDNODERANGING_DRIVER_LOG_LEVEL_WRN=y

CONFIG_OPENTHREAD_DEBUG=y
CONFIG_OPENTHREAD_L2_DEBUG=y
CONFIG_OPENTHREAD_LOG_LEVEL_INFO=y
# CONFIG_OPENTHREAD_LOG_LEVEL_DEBG=y
CONFIG_OPENTHREAD_L2_LOG_LEVEL_INF=y
# CONFIG_OPENTHREAD_L2_LOG_LEVEL_DBG=y

# Enable diagnostic module, uncomment if needed
#CONFIG_OPENTHREAD_DIAG=y
```

## overlay-ot-rnb.conf
```kconfig
#
# Copyright (c) 2022 RedNodeLabs
#

CONFIG_NEWLIB_LIBC=y

# Disable TCP and IPv4 (TCP disabled to avoid heavy traffic)
CONFIG_NET_TCP=n
CONFIG_NET_IPV4=n

CONFIG_NET_IPV6_NBR_CACHE=n
CONFIG_NET_IPV6_MLD=n
CONFIG_NET_CONFIG_NEED_IPV4=n
CONFIG_NET_CONFIG_MY_IPV4_ADDR=""
CONFIG_NET_CONFIG_PEER_IPV4_ADDR=""

CONFIG_SYSTEM_WORKQUEUE_STACK_SIZE=2048
CONFIG_SYSTEM_WORKQUEUE_PRIORITY=1
CONFIG_MAIN_STACK_SIZE=2048

CONFIG_NET_L2_OPENTHREAD=y

CONFIG_OPENTHREAD_DEBUG=y
CONFIG_OPENTHREAD_L2_DEBUG=y
CONFIG_OPENTHREAD_L2_LOG_LEVEL_INF=y

# mbedTLS tweaks
CONFIG_MBEDTLS_SSL_MAX_CONTENT_LEN=768

# A sample configuration to enable Thread Joiner, uncomment if needed
#CONFIG_OPENTHREAD_JOINER=y
#CONFIG_OPENTHREAD_JOINER_AUTOSTART=y

# Enable diagnostic module, uncomment if needed
#CONFIG_OPENTHREAD_DIAG=y

CONFIG_SHELL=n
CONFIG_NET_SHELL=n
CONFIG_NET_MGMT=n
CONFIG_NET_STATISTICS=n
CONFIG_CONSOLE=n
CONFIG_SERIAL=n
CONFIG_FLASH_SHELL=n
CONFIG_OPENTHREAD_MTD=y
CONFIG_OPENTHREAD_SLAAC=y

# Network buffers
CONFIG_OPENTHREAD_NUM_MESSAGE_BUFFERS=16
CONFIG_NET_PKT_RX_COUNT=4
CONFIG_NET_PKT_TX_COUNT=4
CONFIG_NET_BUF_RX_COUNT=16
CONFIG_NET_BUF_TX_COUNT=16

# RedNodeBus specific
CONFIG_REDNODEBUS=y
```

## boards/qorvo_dwm3001c_dev.conf
```kconfig
CONFIG_DK_LIBRARY=y

CONFIG_OPENTHREAD_JOINER=y
CONFIG_OPENTHREAD_JOINER_AUTOSTART=y
CONFIG_OPENTHREAD_JOINER_PSKD="RNL123"

CONFIG_OPENTHREAD_PANID=38339
CONFIG_OPENTHREAD_NETWORK_NAME="RedNodeLabs"
CONFIG_OPENTHREAD_XPANID="0xdead00beef00cafe"
```

## boards/nrf52840dongle_nrf52840.overlay
```dts
/* Copyright (c) 2022 RedNodeLabs.
 *
 */

/ {
	/*
	* In some default configurations within the nRF Connect SDK,
	* e.g. on nRF52840, the chosen zephyr,entropy node is &cryptocell.
	* This devicetree overlay ensures that default is overridden wherever it
	* is set, as this application uses the RNG node for entropy exclusively.
	*/
	chosen {
		zephyr,entropy = &rng;
	};

	aliases {
		rnb-tx-led = &led1_red;
		rnb-rx-led = &led0_green;
	};
};
```

## boards/qorvo_dwm3001c_dev.overlay
```dts
/* Copyright (c) 2022 RedNodeLabs.
 *
 */

/ {
	aliases {
		rnb-tx-led = &led0_red;
		rnb-rx-led = &led1_green;
	};
};
```

## src/main.c
```c
/* main.c - RedNodeBus node */

/*
 * Copyright (c) 2022 RedNodeLabs.
 *
 * SPDX-License-Identifier: Apache-2.0
 */

#include <logging/log.h>
LOG_MODULE_REGISTER(rednodebus_node, LOG_LEVEL_INF);

#ifdef CONFIG_REDNODEBUS
#include "rnb_utils.h"
#endif /* CONFIG_REDNODEBUS */

void main(void)
{
    LOG_INF("RedNodeBus node sample");

#ifdef CONFIG_REDNODEBUS
    init_rnb();
#endif /* CONFIG_REDNODEBUS */
}
```

## src/rnb.c
```c
/* rnb.c - RedNodeBus specific code for node */

/*
 * Copyright (c) 2022 RedNodeLabs.
 *
 * SPDX-License-Identifier: Apache-2.0
 */

#include <logging/log.h>
LOG_MODULE_DECLARE(rednodebus_node, LOG_LEVEL_DBG);

#include <zephyr.h>
#include <errno.h>
#include <stdio.h>

#include <net/ieee802154_radio.h>

/* Convenience defines for RADIO */
#define REDNODEBUS_API(dev) \
		((const struct ieee802154_radio_api * const)(dev)->api)


void handle_radio_rnb_user_event(const struct device *dev,
      enum rednodebus_user_event evt,
      void *event_params)
{
	ARG_UNUSED(dev);

	const struct rednodebus_user_event_params *rnb_user_event_params =
			(const struct rednodebus_user_event_params *) event_params;

	switch (evt)
	{
	case REDNODEBUS_USER_EVENT_NEW_STATE:
		LOG_INF("RNB user event");
		LOG_DBG("RNB state %u", rnb_user_event_params->state);
		LOG_DBG("RNB role %u", rnb_user_event_params->role);
		LOG_DBG("RNB period ms %u", rnb_user_event_params->period_ms);
		LOG_DBG("RNB UWB mode %u", rnb_user_event_params->uwb_mode);
		LOG_DBG("RNB ranging mode %u", rnb_user_event_params->ranging_mode);
		break;
	default:
		LOG_WRN("RNB user event unknown");
		break;
	}
}

int init_rnb(void)
{
	const struct device *dev = device_get_binding(CONFIG_IEEE802154_NRF5_DRV_NAME);
	struct ieee802154_config ieee802154_config;
	struct rednodebus_user_config rnb_user_config;

	ieee802154_config.rnb_user_event_handler = handle_radio_rnb_user_event;
	REDNODEBUS_API(dev)->configure(dev, REDNODEBUS_CONFIG_USER_EVENT_HANDLER, &ieee802154_config);

	rnb_user_config.ranging_enabled = true;
	rnb_user_config.ranging_period_ms = 0;
	REDNODEBUS_API(dev)->configure_rnb(dev, &rnb_user_config);

	REDNODEBUS_API(dev)->start_rnb(dev, REDNODEBUS_USER_ROLE_UNDEFINED);

	return 0;
}
```

## src/rnb.h
```c
/*
 * Copyright (c) 2022 RedNodeLabs.
 *
 * SPDX-License-Identifier: Apache-2.0
 */


#if defined(CONFIG_REDNODEBUS)
int init_rnb(void);
#endif
```

## src/rnb_utils.c
```c
/* rnb.c - RedNodeBus specific code for node */

/*
 * Copyright (c) 2022 RedNodeLabs.
 *
 * SPDX-License-Identifier: Apache-2.0
 */

#include <logging/log.h>
LOG_MODULE_DECLARE(rednodebus_node, LOG_LEVEL_DBG);

#include <zephyr.h>
#include <errno.h>
#include <stdio.h>

#include <net/ieee802154_radio.h>
#include <net/openthread.h>

/* Convenience defines for RADIO */
#define REDNODEBUS_API(dev) \
		((const struct ieee802154_radio_api * const)(dev)->api)

static bool is_rnb_configured;
static struct rednodebus_user_config rnb_user_config;
static struct rednodebus_user_ranging_config rnb_user_ranging_config;


void print_rnb_state(const uint8_t state)
{
	switch (state)
	{
	case REDNODEBUS_USER_BUS_STATE_CONNECTED:
		LOG_INF("RNB state: CONNECTED");
		break;
	case REDNODEBUS_USER_BUS_STATE_SYNCHRONIZED:
		LOG_INF("RNB state: SYNCHRONIZED");
		break;
	case REDNODEBUS_USER_BUS_STATE_UNSYNCHRONIZED:
		LOG_INF("RNB state: UNSYNCHRONIZED");
		break;
	case REDNODEBUS_USER_BUS_STATE_STOPPED:
		LOG_INF("RNB state: STOPPED");
		break;
	default:
		LOG_WRN("RNB state: unknown");
		break;
	}
}

void print_rnb_role(const uint8_t role)
{
	switch (role)
	{
	case REDNODEBUS_USER_ROLE_TAG:
		LOG_INF("RNB role: TAG");
		break;
	case REDNODEBUS_USER_ROLE_ANCHOR:
		LOG_INF("RNB role: ANCHOR");
		break;
	case REDNODEBUS_USER_ROLE_UNDEFINED:
		LOG_INF("RNB role: UNDEFINED");
		break;
	default:
		LOG_WRN("RNB role: unknown");
		break;
	}
}

void print_rnb_uwb_mode(const uint8_t uwb_mode)
{
	switch (uwb_mode)
	{
	case REDNODEBUS_USER_UWB_MODE_HIGH_RATE_CTXP:
		LOG_INF("RNB UWB mode: HIGH_RATE_CTXP");
		break;
	case REDNODEBUS_USER_UWB_MODE_LONG_RANGE_CTXP:
		LOG_INF("RNB UWB mode: LONG_RANGE_CTXP");
		break;
	case REDNODEBUS_USER_UWB_MODE_HIGH_RATE_STXP:
		LOG_INF("RNB UWB mode: HIGH_RATE_STXP");
		break;
	case REDNODEBUS_USER_UWB_MODE_LONG_RANGE_STXP:
		LOG_INF("RNB UWB mode: LONG_RANGE_STXP");
		break;
	case REDNODEBUS_USER_UWB_MODE_NONE:
		LOG_INF("RNB UWB mode: MODE_NONE");
		break;
	default:
		LOG_WRN("RNB UWB mode: unknown");
		break;
	}
}

void print_rnb_ranging_mode(const uint8_t ranging_mode)
{
	switch (ranging_mode)
	{
	case REDNODEBUS_USER_RANGING_MODE_2W_T2A:
		LOG_INF("RNB ranging mode: 2W_T2A");
		break;
	case REDNODEBUS_USER_RANGING_MODE_2W_A2T:
		LOG_INF("RNB ranging mode: 2W_A2T");
		break;
	case REDNODEBUS_USER_RANGING_MODE_3W_A2T:
		LOG_INF("RNB ranging mode: HIGH_RATE_STXP");
		break;
	case REDNODEBUS_USER_RANGING_MODE_3W_A2A:
		LOG_INF("RNB ranging mode: 3W_A2T");
		break;
	case REDNODEBUS_USER_RANGING_MODE_DISABLED:
		LOG_INF("RNB ranging mode: DISABLED");
		break;
	default:
		LOG_WRN("RNB ranging mode: unknown");
		break;
	}
}

void handle_radio_rnb_user_event(const struct device *dev,
      enum rednodebus_user_event evt,
      void *event_params)
{
	ARG_UNUSED(dev);

	const struct rednodebus_user_event_params *rnb_user_event_params =
			(const struct rednodebus_user_event_params *) event_params;

	switch (evt)
	{
	case REDNODEBUS_USER_EVENT_NEW_STATE:
		LOG_DBG("RNB user event new state");

		print_rnb_state(rnb_user_event_params->state);

		if (rnb_user_event_params->state > REDNODEBUS_USER_BUS_STATE_UNSYNCHRONIZED)
		{
			if (rnb_user_event_params->role != REDNODEBUS_USER_ROLE_UNDEFINED)
			{
				print_rnb_role(rnb_user_event_params->role);
			}

			LOG_INF("RNB period ms %u", rnb_user_event_params->period_ms);
		}
		else if (rnb_user_event_params->state == REDNODEBUS_USER_BUS_STATE_STOPPED)
		{
			if (!is_rnb_configured)
			{
				REDNODEBUS_API(dev)->configure_rnb(dev, &rnb_user_config);

				REDNODEBUS_API(dev)->configure_rnb_ranging(dev, &rnb_user_ranging_config);

				is_rnb_configured = true;

				openthread_start(openthread_get_default_context());
			}
		}

		if (rnb_user_event_params->ranging_mode != REDNODEBUS_USER_RANGING_MODE_DISABLED)
		{
			print_rnb_uwb_mode(rnb_user_event_params->uwb_mode);
			print_rnb_ranging_mode(rnb_user_event_params->ranging_mode);
		}
		break;
	default:
		LOG_WRN("RNB user event: unknown");
		break;
	}
}

int init_rnb(void)
{
	is_rnb_configured = false;
	
	const struct device *dev = device_get_binding(CONFIG_IEEE802154_NRF5_DRV_NAME);
	struct ieee802154_config ieee802154_config;

	ieee802154_config.rnb_user_event_handler = handle_radio_rnb_user_event;
	REDNODEBUS_API(dev)->configure(dev, REDNODEBUS_CONFIG_USER_EVENT_HANDLER, &ieee802154_config);

	rnb_user_config.network_id = 0;
	rnb_user_config.role = REDNODEBUS_USER_ROLE_UNDEFINED;
	rnb_user_config.sync_active_period_ms = 2000;
	rnb_user_config.sync_sleep_period_ms = 10000;
	
	rnb_user_ranging_config.ranging_enabled = true;
	rnb_user_ranging_config.ranging_period_ms = 0;

	return 0;
}
```
