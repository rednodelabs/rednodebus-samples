## CMakeLists.txt
```
# SPDX-License-Identifier: Apache-2.0

cmake_minimum_required(VERSION 3.20.0)

list(APPEND DTS_ROOT ${CMAKE_CURRENT_SOURCE_DIR}/../..)
list(APPEND BOARD_ROOT ${CMAKE_CURRENT_SOURCE_DIR}/../..)

string(REPLACE " " ";" OVERLAY_CONFIG_LIST "${OVERLAY_CONFIG}")
if("overlay-ot-rnb.conf" IN_LIST OVERLAY_CONFIG_LIST)
  include(${CMAKE_CURRENT_SOURCE_DIR}/../common/CMakeLists.txt)
endif ()

find_package(Zephyr REQUIRED HINTS $ENV{ZEPHYR_BASE})

project(echo_client)

target_sources(app PRIVATE src/echo-client.c)

target_include_directories(app PUBLIC ${CMAKE_CURRENT_SOURCE_DIR}/../../include)

target_sources_ifdef(CONFIG_NET_UDP app PRIVATE src/udp.c)
target_sources_ifdef(CONFIG_NET_TCP app PRIVATE src/tcp.c)
target_sources_ifdef(CONFIG_NET_VLAN app PRIVATE src/vlan.c)
target_sources_ifdef(CONFIG_USE_REDNODEBUS_USER_PAYLOAD app PRIVATE src/rnb-user-payload.c)
target_include_directories_ifdef(CONFIG_REDNODEBUS app PUBLIC
  ${CMAKE_CURRENT_SOURCE_DIR}/../common/src)
target_sources_ifdef(CONFIG_REDNODEBUS app PRIVATE
  ${CMAKE_CURRENT_SOURCE_DIR}/../common/src/rnb_utils.c
  ${CMAKE_CURRENT_SOURCE_DIR}/../common/src/rnb_leds.c
  ${CMAKE_CURRENT_SOURCE_DIR}/../common/src/rnb_pa_lna.c)
target_sources_ifdef(CONFIG_REDNODERANGING app PRIVATE
  ${CMAKE_CURRENT_SOURCE_DIR}/../common/src/rnb_ranging_port.c
  ${CMAKE_CURRENT_SOURCE_DIR}/../common/src/rnb_ranging_spi.c
  ${CMAKE_CURRENT_SOURCE_DIR}/../common/src/rnb_ranging_sleep.c)

include(${ZEPHYR_BASE}/samples/net/common/common.cmake)
```

## sample.yaml
```
sample:
  name: Socket Echo Client
  description: Test network sockets using a client/server sample
tests:
  sample.echo_client.rnb:
    build_only: true
    platform_allow: nrf52832_mdk nrf52840dk_nrf52840 nrf52833dk_nrf52833 nrf52840dongle_nrf52840 decawave_dwm1001_dev insightsip_isp3010_dev qorvo_dwm3001c_dev rnl_w1 rnl_w1x fanstel_bu840xe
    tags: ci_build
    extra_args: OVERLAY_CONFIG=overlay-ot-rnb.conf
    integration_platforms:
      - nrf52840dk_nrf52840
      - decawave_dwm1001_dev
      - qorvo_dwm3001c_dev
      - rnl_w1
      - rnl_w1x
  sample.echo_client.rnb.rnb_user_payload:
    platform_allow: nrf52832_mdk nrf52840dk_nrf52840 nrf52833dk_nrf52833 nrf52840dongle_nrf52840 decawave_dwm1001_dev insightsip_isp3010_dev qorvo_dwm3001c_dev rnl_w1 rnl_w1x fanstel_bu840xe
    integration_platforms:
      - nrf52840dk_nrf52840
      - decawave_dwm1001_dev
      - qorvo_dwm3001c_dev
      - rnl_w1
      - rnl_w1x
    extra_args: OVERLAY_CONFIG=overlay-ot-rnb.conf;overlay-rnb-user-payload.conf
    build_only: true
    tags: ci_build
```

## prj.conf
```kconfig
# Copyright (c) 2024 RedNodeLabs.

# Generic networking options
CONFIG_NETWORKING=y
CONFIG_NET_UDP=y
CONFIG_NET_TCP=y
CONFIG_NET_IPV6=y
CONFIG_NET_IPV4=y
CONFIG_NET_SOCKETS=y
CONFIG_NET_SOCKETS_POSIX_NAMES=y
CONFIG_NET_SOCKETS_POLL_MAX=4
CONFIG_NET_CONNECTION_MANAGER=y

# Kernel options
CONFIG_ENTROPY_GENERATOR=y
CONFIG_TEST_RANDOM_GENERATOR=y
CONFIG_INIT_STACKS=y

# Logging
CONFIG_NET_LOG=y
CONFIG_LOG=y
CONFIG_NET_STATISTICS=n
CONFIG_PRINTK=y

# Network buffers
CONFIG_NET_PKT_RX_COUNT=16
CONFIG_NET_PKT_TX_COUNT=16
CONFIG_NET_BUF_RX_COUNT=80
CONFIG_NET_BUF_TX_COUNT=80
CONFIG_NET_CONTEXT_NET_PKT_POOL=n

# IP address options
CONFIG_NET_IF_UNICAST_IPV6_ADDR_COUNT=6
CONFIG_NET_IF_MCAST_IPV6_ADDR_COUNT=8
CONFIG_NET_MAX_CONTEXTS=10

# Network shell
CONFIG_NET_SHELL=y

# The addresses are selected so that qemu<->qemu connectivity works ok.
# For linux<->qemu connectivity, create a new conf file and swap the
# addresses (so that peer address is ending to 2).
CONFIG_NET_CONFIG_SETTINGS=n
CONFIG_NET_CONFIG_NEED_IPV6=y
#CONFIG_NET_CONFIG_MY_IPV6_ADDR="2001:db8::2"
#CONFIG_NET_CONFIG_PEER_IPV6_ADDR="2001:0db8:0001:ffff:0000:0000:ac11:0001"
CONFIG_NET_CONFIG_NEED_IPV4=y
#CONFIG_NET_CONFIG_MY_IPV4_ADDR="192.0.2.2"
#CONFIG_NET_CONFIG_PEER_IPV4_ADDR="192.0.2.1"
```

## overlay-debug.conf
```kconfig
#
# Copyright (c) 2022 RedNodeLabs
#

CONFIG_USE_SEGGER_RTT=y
CONFIG_LOG_BACKEND_RTT=y

CONFIG_LOG=y
CONFIG_NET_LOG=y
CONFIG_SHELL=y
CONFIG_OPENTHREAD_SHELL=y
CONFIG_SHELL_BACKEND_SERIAL=y
CONFIG_SHELL_LOG_BACKEND=n
CONFIG_NET_SHELL=y
```

## overlay-ot-rnb.conf
```kconfig
#
# Copyright (c) 2022 RedNodeLabs
#

CONFIG_NEWLIB_LIBC=y

# Disable TCP and IPv4 (TCP disabled to avoid heavy traffic)
CONFIG_NET_TCP=n
CONFIG_NET_IPV4=n

CONFIG_NET_IPV6_NBR_CACHE=n
CONFIG_NET_IPV6_MLD=n
CONFIG_NET_CONFIG_NEED_IPV4=n
CONFIG_NET_CONFIG_MY_IPV4_ADDR=""
CONFIG_NET_CONFIG_PEER_IPV4_ADDR=""

CONFIG_SYSTEM_WORKQUEUE_STACK_SIZE=2048
CONFIG_MAIN_STACK_SIZE=2048

CONFIG_NET_L2_OPENTHREAD=y

#CONFIG_OPENTHREAD_DEBUG=y
#CONFIG_OPENTHREAD_L2_DEBUG=y
#CONFIG_OPENTHREAD_L2_LOG_LEVEL_INF=y

CONFIG_SHELL=n
CONFIG_NET_SHELL=n
CONFIG_NET_MGMT=n
CONFIG_NET_STATISTICS=n
CONFIG_CONSOLE=n
CONFIG_SERIAL=n
CONFIG_USE_SEGGER_RTT=n
CONFIG_FLASH_SHELL=n
CONFIG_OPENTHREAD_MTD=y
CONFIG_OPENTHREAD_SLAAC=y

# Network buffers
CONFIG_OPENTHREAD_NUM_MESSAGE_BUFFERS=32
CONFIG_NET_PKT_RX_COUNT=4
CONFIG_NET_PKT_TX_COUNT=4
CONFIG_NET_BUF_RX_COUNT=16
CONFIG_NET_BUF_TX_COUNT=16
```

## overlay-rednodebus-debug.conf
```kconfig
CONFIG_NEWLIB_LIBC_FLOAT_PRINTF=y

# For Low Power Measurements disable both SERIAL and RTT
CONFIG_SERIAL=n
CONFIG_USE_SEGGER_RTT=y

CONFIG_CONSOLE=n
CONFIG_STDOUT_CONSOLE=n
CONFIG_UART_CONSOLE=n
CONFIG_RTT_CONSOLE=n

CONFIG_LOG_PRINTK=y
CONFIG_LOG_BACKEND_RTT=y
CONFIG_LOG_BACKEND_UART=n

CONFIG_SHELL_BACKEND_RTT=n
CONFIG_SHELL_BACKEND_SERIAL=n
```

## overlay-rednodebus-ot.conf
```kconfig
CONFIG_NEWLIB_LIBC=y

# Disable TCP and IPv4 (TCP disabled to avoid heavy traffic)
CONFIG_NET_TCP=n
CONFIG_NET_IPV4=n

CONFIG_NET_IPV6_NBR_CACHE=n
CONFIG_NET_IPV6_MLD=n
CONFIG_NET_CONFIG_NEED_IPV4=n
CONFIG_NET_CONFIG_MY_IPV4_ADDR=""
CONFIG_NET_CONFIG_PEER_IPV4_ADDR=""

CONFIG_SYSTEM_WORKQUEUE_STACK_SIZE=2048

# RedNodeBus specific
CONFIG_REDNODEBUS=y
CONFIG_TEST_RANDOM_GENERATOR=n
# >> OT
CONFIG_REDNODEBUS_EMPTY_PAYLOAD=n
CONFIG_REDNODEBUS_REDNODERANGING_DIAGNOSTIC_ENABLED=n
# <<
CONFIG_REDNODEBUS_DRIVER_LOG_LEVEL_INF=y

#######################
CONFIG_FLASH_SHELL=n
CONFIG_NET_SHELL=n
CONFIG_NET_LOG=n
CONFIG_SERIAL=n

#CONFIG_REDNODEBUS_NRF5_RX_STACK_SIZE=800
#CONFIG_REDNODEBUS_NRF5_REDNODEBUS_EVENT_STACK_SIZE=800
#CONFIG_NRF_REDNODEBUS_EVENT_BUFFERS=6
#CONFIG_NRF_REDNODEBUS_RX_BUFFERS=8

#CONFIG_MAIN_STACK_SIZE=2048
#CONFIG_PRIVILEGED_STACK_SIZE=1024

#CONFIG_SYSTEM_WORKQUEUE_STACK_SIZE=2048
#CONFIG_MBEDTLS_HEAP_SIZE=10240
#CONFIG_OPENTHREAD_THREAD_STACK_SIZE=6240
#CONFIG_OPENTHREAD_RADIO_WORKQUEUE_STACK_SIZE=736

#CONFIG_MBEDTLS_SSL_MAX_CONTENT_LEN=768

#CONFIG_IDLE_STACK_SIZE=320
#CONFIG_ISR_STACK_SIZE=2048

CONFIG_CONSOLE=n

CONFIG_OPENTHREAD_NUM_MESSAGE_BUFFERS=8

CONFIG_NET_PKT_RX_COUNT=10
CONFIG_NET_PKT_TX_COUNT=16
CONFIG_NET_BUF_RX_COUNT=16
CONFIG_NET_BUF_TX_COUNT=16

#CONFIG_NET_TX_STACK_SIZE=1200
#CONFIG_NET_RX_STACK_SIZE=1500

#CONFIG_NET_MGMT=n
CONFIG_NET_STATISTICS=n

#######################

# Enable OpenThread shell
CONFIG_SHELL=n
CONFIG_OPENTHREAD_SHELL=n
#CONFIG_SHELL_STACK_SIZE=3072

CONFIG_NET_L2_OPENTHREAD=y

#CONFIG_OPENTHREAD_DEBUG=y
#CONFIG_OPENTHREAD_LOG_LEVEL_INFO=y
#CONFIG_OPENTHREAD_L2_DEBUG=y
#CONFIG_OPENTHREAD_L2_LOG_LEVEL_INF=y

CONFIG_OPENTHREAD_CHANNEL=26
CONFIG_OPENTHREAD_NETWORKKEY="00:11:22:33:44:55:66:77:88:99:aa:bb:cc:dd:ee:ff"

#CONFIG_NET_CONFIG_MY_IPV6_ADDR="fdde:ad00:beef::1"
#CONFIG_NET_CONFIG_PEER_IPV6_ADDR="fdde:ad00:beef::2"

# mbedTLS tweaks
CONFIG_MBEDTLS_SSL_MAX_CONTENT_LEN=768

# A sample configuration to enable Thread Joiner, uncomment if needed
#CONFIG_OPENTHREAD_JOINER=y
#CONFIG_OPENTHREAD_JOINER_AUTOSTART=y

# Enable diagnostic module, uncomment if needed
#CONFIG_OPENTHREAD_DIAG=y

CONFIG_OPENTHREAD_MTD=y
CONFIG_OPENTHREAD_PING_SENDER=y
CONFIG_OPENTHREAD_DHCP6_CLIENT=y
CONFIG_OPENTHREAD_SLAAC=y
#CONFIG_OPENTHREAD_DNS_CLIENT=y

# RedNodeRanging specific
CONFIG_REDNODERANGING=y
CONFIG_REDNODERANGING_DRIVER_LOG_LEVEL_INF=y

CONFIG_SPI_BLOCKING=y
```

## overlay-rednodebus.conf
```kconfig
CONFIG_BT=n

# Disable TCP and IPv4 (TCP disabled to avoid heavy traffic)
CONFIG_NET_TCP=n
CONFIG_NET_IPV4=n

CONFIG_NET_CONFIG_NEED_IPV6=y
CONFIG_NET_CONFIG_NEED_IPV4=n
CONFIG_NET_CONFIG_MY_IPV4_ADDR=""
CONFIG_NET_CONFIG_PEER_IPV4_ADDR=""

#CONFIG_NET_L2_IEEE802154=y
#CONFIG_NET_L2_IEEE802154_SHELL=y
#CONFIG_NET_L2_IEEE802154_LOG_LEVEL_INF=y

#CONFIG_NET_CONFIG_IEEE802154_CHANNEL=26

# RedNodeBus specific
CONFIG_NET_STATISTICS=n
CONFIG_LOG=n

CONFIG_PM=y
CONFIG_PM_DEVICE=y

CONFIG_WATCHDOG=y
CONFIG_WDT_DISABLE_AT_BOOT=n

CONFIG_TEST_RANDOM_GENERATOR=n
CONFIG_XOROSHIRO_RANDOM_GENERATOR=y

CONFIG_NET_LOG=n
CONFIG_NET_L2_IEEE802154_SHELL=n
CONFIG_NET_SHELL=n
CONFIG_NET_UDP=n

CONFIG_NEWLIB_LIBC=y

CONFIG_REDNODEBUS=y
CONFIG_NRF_REDNODEBUS_EVENT_CALLBACKS=1
# >> OT
CONFIG_REDNODEBUS_EMPTY_PAYLOAD=n
CONFIG_REDNODEBUS_REDNODERANGING_MAX_REPORTER_COUNT=2
# <<
CONFIG_REDNODEBUS_DRIVER_LOG_LEVEL_ERR=y

CONFIG_REDNODERANGING=y
CONFIG_REDNODERANGING_DRIVER_LOG_LEVEL_ERR=y

CONFIG_SPI_BLOCKING=y

CONFIG_SERIAL=n

CONFIG_USE_SEGGER_RTT=n
```

## overlay-rnb-user-payload.conf
```kconfig
#
# Copyright (c) 2025 RedNodeLabs
#

CONFIG_USE_REDNODEBUS_USER_PAYLOAD=y
CONFIG_USE_REDNODEBUS_USER_PAYLOAD_ONLY=y
```

## src/common.h
```c
/*
 * Copyright (c) 2017 Intel Corporation.
 * Copyright (c) 2018 Nordic Semiconductor ASA.
 *
 * SPDX-License-Identifier: Apache-2.0
 */

#include <net/ieee802154_radio.h>

/* Value of 0 will cause the IP stack to select next free port */
#define MY_PORT 0

#define PEER_PORT 4242

#if IS_ENABLED(CONFIG_NET_TC_THREAD_PREEMPTIVE)
#define THREAD_PRIORITY K_PRIO_PREEMPT(8)
#else
#define THREAD_PRIORITY K_PRIO_COOP(CONFIG_NUM_COOP_PRIORITIES - 1)
#endif

struct data {
	const char *proto;

	struct {
		int sock;
		/* Work controlling udp data sending */
		struct k_work_delayable recv;
		struct k_work_delayable transmit;
		uint32_t expecting;
		uint32_t counter;
		uint32_t mtu;
	} udp;

	struct {
		int sock;
		uint32_t expecting;
		uint32_t received;
		uint32_t counter;
	} tcp;
};
struct data_rnb {
	const char *proto;

	struct {
		struct rednodebus_user_payload_params rnb_user_payload_params;
		/* Work controlling rnb data sending */
		struct k_work_delayable recv;
		struct k_work_delayable transmit;
		uint32_t expecting;
		uint32_t counter;
		uint32_t mtu;
	} rnb_user_payload;
};

struct configs {
	struct data ipv6;
};
struct configs_rnb {
	struct data_rnb rnb;
};

#if !defined(CONFIG_NET_CONFIG_PEER_IPV6_ADDR)
#define CONFIG_NET_CONFIG_PEER_IPV6_ADDR "2001:0db8:0001:ffff:0000:0000:ac11:0001"
#endif

extern const char lorem_ipsum[];
extern const int ipsum_len;
extern struct configs conf;
extern struct configs_rnb conf_rnb;

int start_udp(void);
int process_udp(void);
void stop_udp(void);

int start_tcp(void);
int process_tcp(void);
void stop_tcp(void);

int start_rnb_user_payload(void);
int process_rnb_user_payload(void);
void stop_rnb_user_payload(void);
void wait_rnb_user_payload_reply(void);
void rnb_utils_handle_user_payload(const uint8_t user_payload_length,
				   const struct rednodebus_user_event_params_user_payload *user_payload);

#if defined(CONFIG_NET_VLAN)
int init_vlan(void);
#else
static inline int init_vlan(void)
{
	return 0;
}
#endif
```

## src/echo-client.c
```c
/* echo-client.c - Networking echo client */

/*
 * Copyright (c) 2017 Intel Corporation.
 * Copyright (c) 2018 Nordic Semiconductor ASA.
 *
 * SPDX-License-Identifier: Apache-2.0
 */

/*
 * The echo-client application is acting as a client that is run in Zephyr OS,
 * and echo-server is run in the host acting as a server. The client will send
 * either unicast or multicast packets to the server which will reply the packet
 * back to the originator.
 *
 * In this sample application we create four threads that start to send data.
 * This might not be what you want to do in your app so caveat emptor.
 */

#include <logging/log.h>
LOG_MODULE_REGISTER(net_echo_client_sample, LOG_LEVEL_DBG);

#include <zephyr.h>
#include <errno.h>
#include <stdio.h>

#include <net/socket.h>

#include <net/net_mgmt.h>
#include <net/net_event.h>
#include <net/net_conn_mgr.h>
#ifdef CONFIG_REDNODEBUS
#include <net/ieee802154_radio.h>
#include "rnb_utils.h"
#endif /* CONFIG_REDNODEBUS */

#include "common.h"

#define APP_BANNER "Run echo client"

#define INVALID_SOCK (-1)

#define EVENT_MASK (NET_EVENT_L4_CONNECTED | \
		    NET_EVENT_L4_DISCONNECTED)

#define MTU_SIZE 1280

/* Generated by http://www.lipsum.com/
 * 2 paragraphs, 179 words, 1160 bytes of Lorem Ipsum
 */
const char lorem_ipsum[] =
	"Lorem ipsum dolor sit amet, consectetur adipiscing elit. Quisque "
	"sodales lorem lorem, sed congue enim vehicula a. Sed finibus diam sed "
	"odio ultrices pharetra. Nullam dictum arcu ultricies turpis congue, "
	"vel venenatis turpis venenatis. Nam tempus arcu eros, ac congue libero "
	"tristique congue. Proin velit lectus, euismod sit amet quam in, "
	"maximus condimentum urna. Cras vel erat luctus, mattis orci ut, varius "
	"urna. Nam eu lobortis velit."
	"\n"
	"Nullam sit amet diam vel odio sodales cursus vehicula eu arcu. Proin "
	"fringilla, enim nec consectetur mollis, lorem orci interdum nisi, "
	"vitae suscipit nisi mauris eu mi. Proin diam enim, mollis ac rhoncus "
	"vitae, placerat et eros. Suspendisse convallis, ipsum nec rhoncus "
	"aliquam, ex augue ultrices nisl, id aliquet mi diam quis ante. "
	"Pellentesque venenatis ornare ultrices. Quisque et porttitor lectus. "
	"Ut venenatis nunc et urna imperdiet porttitor non laoreet massa. Donec "
	"eleifend eros in mi sagittis egestas. Sed et mi nunc. Nunc vulputate, "
	"mauris non ullamcorper viverra, lorem nulla vulputate diam, et congue "
	"dui velit non erat. Duis interdum leo et ipsum tempor consequat. In "
	"faucibus enim quis purus vulputate nullam."
	"\n";

const int ipsum_len = sizeof(lorem_ipsum) - 1;

#if !defined(CONFIG_USE_REDNODEBUS_USER_PAYLOAD_ONLY)
struct configs conf = {
	.ipv6 = {
		.proto = "IPv6",
		.udp.sock = INVALID_SOCK,
		.tcp.sock = INVALID_SOCK,
	}
};

static struct pollfd fds[4];
static int nfds;

static bool connected;
K_SEM_DEFINE(run_app, 0, 1);

#if defined(CONFIG_NET_CONNECTION_MANAGER)
static struct net_mgmt_event_callback mgmt_cb;
#endif

static struct k_thread udp_thread;
static K_KERNEL_STACK_MEMBER(udp_stack, 800);
#endif

#if defined(CONFIG_USE_REDNODEBUS_USER_PAYLOAD)
struct configs_rnb conf_rnb = {
	.rnb = {
		.proto = "RNB",
		.rnb_user_payload.mtu = REDNODEBUS_USER_PAYLOAD_MAX_LENGTH,
	}
};

static struct k_thread rnb_thread;
static K_KERNEL_STACK_MEMBER(rnb_stack, 800);
#endif

#if !defined(CONFIG_USE_REDNODEBUS_USER_PAYLOAD_ONLY)
static void prepare_fds(void)
{
	if (conf.ipv6.udp.sock >= 0) {
		fds[nfds].fd = conf.ipv6.udp.sock;
		fds[nfds].events = POLLIN;
		nfds++;
	}

	if (conf.ipv6.tcp.sock >= 0) {
		fds[nfds].fd = conf.ipv6.tcp.sock;
		fds[nfds].events = POLLIN;
		nfds++;
	}
}

static void wait(void)
{
	/* Wait for event on any socket used. Once event occurs,
	 * we'll check them all.
	 */
	if (poll(fds, nfds, -1) < 0) {
		LOG_ERR("Error in poll:%d", errno);
	}
}

static int start(void)
{
	int ret;

	LOG_INF("Starting...");

	if (IS_ENABLED(CONFIG_NET_UDP)) {
		ret = start_udp();
		if (ret < 0) {
			return ret;
		}
	}

	prepare_fds();

	return 0;
}

static int run(void)
{
	int ret;

	wait();

	if (IS_ENABLED(CONFIG_NET_UDP)) {
		ret = process_udp();
		if (ret < 0) {
			return ret;
		}
	}

	return 0;
}

static void stop(void)
{
	LOG_INF("Stopping...");

	if (IS_ENABLED(CONFIG_NET_UDP)) {
		stop_udp();
	}
}

#if defined(CONFIG_NET_CONNECTION_MANAGER)
static void event_handler(struct net_mgmt_event_callback *cb,
			  uint32_t mgmt_event, struct net_if *iface)
{
	if ((mgmt_event & EVENT_MASK) != mgmt_event) {
		return;
	}

	if (mgmt_event == NET_EVENT_L4_CONNECTED) {
		LOG_INF("Network connected");

		connected = true;
		conf.ipv6.udp.mtu = net_if_get_mtu(iface);
		k_sem_give(&run_app);

		return;
	}

	if (mgmt_event == NET_EVENT_L4_DISCONNECTED) {
		LOG_INF("Network disconnected");

		connected = false;
		k_sem_reset(&run_app);

		return;
	}
}
#endif

static void init_app(void)
{
	LOG_INF(APP_BANNER);

	if (IS_ENABLED(CONFIG_NET_CONNECTION_MANAGER)) {
		net_mgmt_init_event_callback(&mgmt_cb,
					     event_handler, EVENT_MASK);
		net_mgmt_add_event_callback(&mgmt_cb);

		net_conn_mgr_resend_status();
	}

	init_vlan();
}

static int start_client(void)
{
	int iterations = 0;
	int i = 0;
	int ret = 0;

	while (iterations == 0 || i < iterations) {
		/* Wait for the connection. */
		k_sem_take(&run_app, K_FOREVER);

		ret = start();

		while (connected && (ret == 0))
 		{

			ret = run();

			if (iterations > 0) {
				i++;
				if (i >= iterations) {
					break;
				}
			}
		}

		stop();
	}

	return ret;
}

static void echo_client_udp_thread(void *arg1, void *arg2, void *arg3)
{
	init_app();

	if (!IS_ENABLED(CONFIG_NET_CONNECTION_MANAGER)) {
		conf.ipv6.udp.mtu = MTU_SIZE;

		connected = true;

		/* If the config library has not been configured to start the
		 * app only after we have a connection, then we can start
		 * it right away.
		 */
		k_sem_give(&run_app);
	}

	exit(start_client());
}
#endif

#if defined(CONFIG_USE_REDNODEBUS_USER_PAYLOAD)
static void wait_rnb(void)
{
	wait_rnb_user_payload_reply();
}

static int start_rnb(void)
{
	int ret;

	LOG_INF("Starting RedNodeBus user payload...");

	ret = start_rnb_user_payload();
	if (ret < 0) {
		return ret;
	}

	return 0;
}

static int run_rnb(void)
{
	int ret;

	wait_rnb();

	ret = process_rnb_user_payload();
	if (ret < 0) {
		return ret;
	}

	return 0;
}

static void stop_rnb(void)
{
	LOG_INF("Stopping RedNodeBus user payload...");

	stop_rnb_user_payload();
}

static void init_app_rnb(void)
{

}

static int start_client_rnb(void)
{
	int iterations = 0;
	int i = 0;
	int ret = 0;

	while (iterations == 0 || i < iterations) {
		ret = start_rnb();

		while (ret == 0)
 		{
			ret = run_rnb();

			if (iterations > 0) {
				i++;
				if (i >= iterations) {
					break;
				}
			}
		}

		stop_rnb();
	}

	return ret;
}

static void echo_client_rnb_thread(void *arg1, void *arg2, void *arg3)
{
	init_app_rnb();

	exit(start_client_rnb());
}
#endif

void main(void)
{
#ifdef CONFIG_REDNODEBUS
	init_rnb();

	while (!is_rnb_connected())
	{
		k_sleep(K_MSEC(1000));
	}
#endif /* CONFIG_REDNODEBUS */

#if !defined(CONFIG_USE_REDNODEBUS_USER_PAYLOAD_ONLY)
	k_thread_create(&udp_thread,
			udp_stack,
			K_THREAD_STACK_SIZEOF(udp_stack),
			echo_client_udp_thread,
			NULL,
			NULL,
			NULL,
			K_PRIO_PREEMPT(7),
			0,
			K_NO_WAIT);
#endif
#if defined(CONFIG_USE_REDNODEBUS_USER_PAYLOAD)
	k_thread_create(&rnb_thread,
			rnb_stack,
			K_THREAD_STACK_SIZEOF(rnb_stack),
			echo_client_rnb_thread,
			NULL,
			NULL,
			NULL,
			K_PRIO_PREEMPT(7),
			0,
			K_NO_WAIT);
#endif
}
```

## src/rnb-user-payload.c
```c
/* rnb-user-payload.c - RedNodeBus payload */

/*
 * Copyright (c) 2025 RedNodeLabs.
 *
 * SPDX-License-Identifier: Apache-2.0
 */

#include <logging/log.h>
LOG_MODULE_DECLARE(net_echo_client_sample, LOG_LEVEL_DBG);

#include <zephyr.h>
#include <errno.h>
#include <stdio.h>

#include <net/ieee802154_radio.h>

#include <random/rand32.h>

#include "common.h"

#define RECV_BUF_SIZE 1280
#define RNB_SLEEP K_MSEC(150)
#define RNB_WAIT K_SECONDS(20)

/* Convenience defines for RADIO */
#define REDNODEBUS_API(dev) ((const struct ieee802154_radio_api *const)(dev)->api)

K_SEM_DEFINE(wait_rnb_data, 0, 1);

static char recv_buf[RECV_BUF_SIZE];
static int received;

static int send_rnb_data(struct data_rnb *data)
{
	const struct device *dev = device_get_binding(CONFIG_IEEE802154_NRF5_DRV_NAME);
	int ret;
	uint16_t rnb_user_payload_params_length;

	do
	{
		data->rnb_user_payload.expecting = sys_rand32_get() % (data->rnb_user_payload.mtu + 1);
	} while (data->rnb_user_payload.expecting == 0U);

	memcpy(&data->rnb_user_payload.rnb_user_payload_params.user_payload, lorem_ipsum, data->rnb_user_payload.expecting);

	rnb_user_payload_params_length = data->rnb_user_payload.expecting;

	ret = REDNODEBUS_API(dev)->send_rnb_user_payload(dev, &data->rnb_user_payload.rnb_user_payload_params, rnb_user_payload_params_length);

	if (ret == 0)
	{
		LOG_DBG("%s USER PAYLOAD: Sent %d bytes", data->proto, data->rnb_user_payload.expecting);
		LOG_HEXDUMP_DBG(&data->rnb_user_payload.rnb_user_payload_params.user_payload, data->rnb_user_payload.expecting, "Data");
	}
	else
	{
		LOG_ERR("%s USER PAYLOAD: error sending %d", data->proto, ret);
	}

	k_work_reschedule(&data->rnb_user_payload.recv, RNB_WAIT);

	return ret < 0 ? -EIO : 0;
}

static int compare_rnb_data(struct data_rnb *data, const char *buf, uint32_t received)
{
	if (received != data->rnb_user_payload.expecting)
	{
		LOG_ERR("%s USER PAYLOAD: Invalid amount of data received:, received %d vs expected %d", data->proto, received, data->rnb_user_payload.expecting);
		return -EIO;
	}

	if (memcmp(buf, lorem_ipsum, received) != 0)
	{
		LOG_ERR("%s USER PAYLOAD: Invalid data received", data->proto);
		return -EIO;
	}

	return 0;
}

static void wait_reply(struct k_work *work)
{
	/* This means that we did not receive response in time. */
	struct data_rnb *data = CONTAINER_OF(work, struct data_rnb, rnb_user_payload.recv);

	LOG_ERR("%s USER PAYLOAD: Data packet not received", data->proto);

	/* Send a new packet at this point */
	send_rnb_data(data);
}

static void wait_transmit(struct k_work *work)
{
	struct data_rnb *data = CONTAINER_OF(work, struct data_rnb, rnb_user_payload.transmit);

	send_rnb_data(data);
}

static int start_rnb_proto(struct data_rnb *data)
{
	int ret = 0;

	k_work_init_delayable(&data->rnb_user_payload.recv, wait_reply);
	k_work_init_delayable(&data->rnb_user_payload.transmit, wait_transmit);

	received = 0;

	return ret;
}

static int process_rnb_proto(struct data_rnb *data)
{
	int ret;

	if (received == 0)
	{
		return -EIO;
	}
	if (received < 0)
	{
		if (errno == EAGAIN || errno == EWOULDBLOCK)
		{
			ret = 0;
		}
		else
		{
			ret = -errno;
		}
		return ret;
	}

	ret = compare_rnb_data(data, recv_buf, received);
	if (ret != 0)
	{
		LOG_WRN("%s: Received and compared %d bytes, data "
			"mismatch",
			data->proto, received);
		return 0;
	}

	/* Correct response received */
	LOG_DBG("%s: Received and compared %d bytes, all ok",
		data->proto, received);

	if (++data->rnb_user_payload.counter % 1000 == 0U)
	{
		LOG_INF("%s USER PAYLOAD: Exchanged %u packets", data->proto,
			data->rnb_user_payload.counter);
	}

	k_work_cancel_delayable(&data->rnb_user_payload.recv);

	ret = send_rnb_data(data);

	return ret;
}

int start_rnb_user_payload(void)
{
	int ret = 0;

	ret = start_rnb_proto(&conf_rnb.rnb);
	if (ret < 0)
	{
		return ret;
	}

	ret = send_rnb_data(&conf_rnb.rnb);
	if (ret < 0)
	{
		return ret;
	}

	return ret;
}

int process_rnb_user_payload(void)
{
	int ret;

	ret = process_rnb_proto(&conf_rnb.rnb);

	return ret;
}

void stop_rnb_user_payload(void)
{
}

void wait_rnb_user_payload_reply(void)
{
	/* Wait for the reply. */
	k_sem_take(&wait_rnb_data, K_FOREVER);
}

void rnb_utils_handle_user_payload(const uint8_t user_payload_length,
				   const struct rednodebus_user_event_params_user_payload *user_payload)
{
	memcpy(recv_buf, &user_payload->user_payload, user_payload_length);

	received = user_payload_length;

	k_sem_give(&wait_rnb_data);
}
```

## src/rnb_utils.c
```c
/* rnb.c - RedNodeBus specific code for node */

/*
 * Copyright (c) 2022 RedNodeLabs.
 *
 * SPDX-License-Identifier: Apache-2.0
 */

#include <logging/log.h>
LOG_MODULE_DECLARE(net_echo_client_sample, LOG_LEVEL_DBG);

#include <zephyr.h>
#include <errno.h>
#include <stdio.h>

#include <net/ieee802154_radio.h>

/* Convenience defines for RADIO */
#define REDNODEBUS_API(dev) \
		((const struct ieee802154_radio_api * const)(dev)->api)

void print_rnb_state(const uint8_t state)
{
	switch (state)
	{
	case REDNODEBUS_USER_BUS_STATE_CONNECTED:
		LOG_INF("RNB state: CONNECTED");
		break;
	case REDNODEBUS_USER_BUS_STATE_SYNCHRONIZED:
		LOG_INF("RNB state: SYNCHRONIZED");
		break;
	case REDNODEBUS_USER_BUS_STATE_UNSYNCHRONIZED:
		LOG_INF("RNB state: UNSYNCHRONIZED");
		break;
	case REDNODEBUS_USER_BUS_STATE_STOPPED:
		LOG_INF("RNB state: STOPPED");
		break;
	default:
		LOG_WRN("RNB state: unknown");
		break;
	}
}

void print_rnb_role(const uint8_t role)
{
	switch (role)
	{
	case REDNODEBUS_USER_ROLE_TAG:
		LOG_INF("RNB role: TAG");
		break;
	case REDNODEBUS_USER_ROLE_ANCHOR:
		LOG_INF("RNB role: ANCHOR");
		break;
	case REDNODEBUS_USER_ROLE_UNDEFINED:
		LOG_INF("RNB role: UNDEFINED");
		break;
	default:
		LOG_WRN("RNB role: unknown");
		break;
	}
}

void print_rnb_uwb_mode(const uint8_t uwb_mode)
{
	switch (uwb_mode)
	{
	case REDNODEBUS_USER_UWB_MODE_HIGH_RATE_CTXP:
		LOG_INF("RNB UWB mode: HIGH_RATE_CTXP");
		break;
	case REDNODEBUS_USER_UWB_MODE_LONG_RANGE_CTXP:
		LOG_INF("RNB UWB mode: LONG_RANGE_CTXP");
		break;
	case REDNODEBUS_USER_UWB_MODE_HIGH_RATE_STXP:
		LOG_INF("RNB UWB mode: HIGH_RATE_STXP");
		break;
	case REDNODEBUS_USER_UWB_MODE_LONG_RANGE_STXP:
		LOG_INF("RNB UWB mode: LONG_RANGE_STXP");
		break;
	case REDNODEBUS_USER_UWB_MODE_NONE:
		LOG_INF("RNB UWB mode: MODE_NONE");
		break;
	default:
		LOG_WRN("RNB UWB mode: unknown");
		break;
	}
}

void print_rnb_ranging_mode(const uint8_t ranging_mode)
{
	switch (ranging_mode)
	{
	case REDNODEBUS_USER_RANGING_MODE_2W_T2A:
		LOG_INF("RNB ranging mode: 2W_T2A");
		break;
	case REDNODEBUS_USER_RANGING_MODE_2W_A2T:
		LOG_INF("RNB ranging mode: 2W_A2T");
		break;
	case REDNODEBUS_USER_RANGING_MODE_3W_A2T:
		LOG_INF("RNB ranging mode: HIGH_RATE_STXP");
		break;
	case REDNODEBUS_USER_RANGING_MODE_3W_A2A:
		LOG_INF("RNB ranging mode: 3W_A2T");
		break;
	case REDNODEBUS_USER_RANGING_MODE_DISABLED:
		LOG_INF("RNB ranging mode: DISABLED");
		break;
	default:
		LOG_WRN("RNB ranging mode: unknown");
		break;
	}
}

void handle_radio_rnb_user_event(const struct device *dev,
      enum rednodebus_user_event evt,
      void *event_params)
{
	ARG_UNUSED(dev);

	const struct rednodebus_user_event_params *rnb_user_event_params =
			(const struct rednodebus_user_event_params *) event_params;

	switch (evt)
	{
	case REDNODEBUS_USER_EVENT_NEW_STATE:
		LOG_DBG("RNB user event");

		print_rnb_state(rnb_user_event_params->state);

		if (rnb_user_event_params->state > REDNODEBUS_USER_BUS_STATE_UNSYNCHRONIZED)
		{
			if (rnb_user_event_params->role != REDNODEBUS_USER_ROLE_UNDEFINED)
			{
				print_rnb_role(rnb_user_event_params->role);
			}

			LOG_INF("RNB period ms %u", rnb_user_event_params->period_ms);
		}

		if (rnb_user_event_params->ranging_mode != REDNODEBUS_USER_RANGING_MODE_DISABLED)
		{
			print_rnb_uwb_mode(rnb_user_event_params->uwb_mode);
			print_rnb_ranging_mode(rnb_user_event_params->ranging_mode);
		}
		break;
	default:
		LOG_WRN("RNB user event: unknown");
		break;
	}
}

int init_rnb(void)
{
	const struct device *dev = device_get_binding(CONFIG_IEEE802154_NRF5_DRV_NAME);
	struct ieee802154_config ieee802154_config;
	struct rednodebus_user_config rnb_user_config;
	const uint8_t network_id = 0;

	ieee802154_config.rnb_user_event_handler = handle_radio_rnb_user_event;
	REDNODEBUS_API(dev)->configure(dev, REDNODEBUS_CONFIG_USER_EVENT_HANDLER, &ieee802154_config);

	rnb_user_config.sync_active_period_ms = 2500;
	rnb_user_config.sync_sleep_period_ms = 5000;
	rnb_user_config.ranging_enabled = true;
	rnb_user_config.ranging_period_ms = 0;
	REDNODEBUS_API(dev)->configure_rnb(dev, &rnb_user_config);

	REDNODEBUS_API(dev)->start_rnb(dev, network_id, REDNODEBUS_USER_ROLE_UNDEFINED);

	return 0;
}
```

## src/udp.c
```c
/* udp.c - UDP specific code for echo client */

/*
 * Copyright (c) 2017 Intel Corporation.
 * Copyright (c) 2018 Nordic Semiconductor ASA.
 *
 * SPDX-License-Identifier: Apache-2.0
 */

#include <logging/log.h>
LOG_MODULE_DECLARE(net_echo_client_sample, LOG_LEVEL_DBG);

#include <zephyr.h>
#include <errno.h>
#include <stdio.h>

#include <net/socket.h>
#include <random/rand32.h>

#include "common.h"

#define RECV_BUF_SIZE 1280
#define UDP_SLEEP K_MSEC(150)
#define UDP_WAIT K_SECONDS(60)

static char recv_buf[RECV_BUF_SIZE];

static int send_udp_data(struct data *data)
{
	int ret;

	do {
		data->udp.expecting = sys_rand32_get() % ipsum_len;
	} while (data->udp.expecting == 0U ||
		 data->udp.expecting > data->udp.mtu);

	ret = send(data->udp.sock, lorem_ipsum, data->udp.expecting, 0);

	LOG_DBG("%s UDP: Sent %d bytes", data->proto, data->udp.expecting);

	k_work_reschedule(&data->udp.recv, UDP_WAIT);

	return ret < 0 ? -EIO : 0;
}

static int compare_udp_data(struct data *data, const char *buf, uint32_t received)
{
	if (received != data->udp.expecting) {
		LOG_ERR("Invalid amount of data received: UDP %s", data->proto);
		return -EIO;
	}

	if (memcmp(buf, lorem_ipsum, received) != 0) {
		LOG_ERR("Invalid data received: UDP %s", data->proto);
		return -EIO;
	}

	return 0;
}

static void wait_reply(struct k_work *work)
{
	/* This means that we did not receive response in time. */
	struct data *data = CONTAINER_OF(work, struct data, udp.recv);

	LOG_ERR("UDP %s: Data packet not received", data->proto);

	/* Send a new packet at this point */
	send_udp_data(data);
}

static void wait_transmit(struct k_work *work)
{
	struct data *data = CONTAINER_OF(work, struct data, udp.transmit);

	send_udp_data(data);
}

static int start_udp_proto(struct data *data, struct sockaddr *addr,
			   socklen_t addrlen)
{
	int ret;

	k_work_init_delayable(&data->udp.recv, wait_reply);
	k_work_init_delayable(&data->udp.transmit, wait_transmit);

	data->udp.sock = socket(addr->sa_family, SOCK_DGRAM, IPPROTO_UDP);

	if (data->udp.sock < 0) {
		LOG_ERR("Failed to create UDP socket (%s): %d", data->proto,
			errno);
		return -errno;
	}

	/* Call connect so we can use send and recv. */
	ret = connect(data->udp.sock, addr, addrlen);
	if (ret < 0) {
		LOG_ERR("Cannot connect to UDP remote (%s): %d", data->proto,
			errno);
		ret = -errno;
	}

	return ret;
}

static int process_udp_proto(struct data *data)
{
	int ret, received;

	received = recv(data->udp.sock, recv_buf, sizeof(recv_buf),
			MSG_DONTWAIT);

	if (received == 0) {
		return -EIO;
	}
	if (received < 0) {
		if (errno == EAGAIN || errno == EWOULDBLOCK) {
			ret = 0;
		} else {
			ret = -errno;
		}
		return ret;
	}

	ret = compare_udp_data(data, recv_buf, received);
	if (ret != 0) {
		LOG_WRN("%s UDP: Received and compared %d bytes, data "
			"mismatch", data->proto, received);
		return 0;
	}

	/* Correct response received */
	LOG_DBG("%s UDP: Received and compared %d bytes, all ok",
		data->proto, received);

	if (++data->udp.counter % 1000 == 0U) {
		LOG_INF("%s UDP: Exchanged %u packets", data->proto,
			data->udp.counter);
	}

	k_work_cancel_delayable(&data->udp.recv);

	/* Do not flood the link if we have also TCP configured */
	if (IS_ENABLED(CONFIG_NET_TCP)) {
		k_work_reschedule(&data->udp.transmit, UDP_SLEEP);
		ret = 0;
	} else {
		ret = send_udp_data(data);
	}

	return ret;
}

int start_udp(void)
{
	int ret = 0;
	struct sockaddr_in6 addr6;

	if (IS_ENABLED(CONFIG_NET_IPV6)) {
		addr6.sin6_family = AF_INET6;
		addr6.sin6_port = htons(PEER_PORT);
		inet_pton(AF_INET6, CONFIG_NET_CONFIG_PEER_IPV6_ADDR,
			  &addr6.sin6_addr);

		ret = start_udp_proto(&conf.ipv6, (struct sockaddr *)&addr6,
				      sizeof(addr6));
		if (ret < 0) {
			return ret;
		}
	}

	if (IS_ENABLED(CONFIG_NET_IPV6)) {
		ret = send_udp_data(&conf.ipv6);
		if (ret < 0) {
			return ret;
		}
	}

	return ret;
}

int process_udp(void)
{
	int ret = 0;

	if (IS_ENABLED(CONFIG_NET_IPV6)) {
		ret = process_udp_proto(&conf.ipv6);
		if (ret < 0) {
			return ret;
		}
	}

	return ret;
}

void stop_udp(void)
{
	if (IS_ENABLED(CONFIG_NET_IPV6)) {
		k_work_cancel_delayable(&conf.ipv6.udp.recv);
		k_work_cancel_delayable(&conf.ipv6.udp.transmit);

		if (conf.ipv6.udp.sock >= 0) {
			(void)close(conf.ipv6.udp.sock);
		}
	}
}
```
