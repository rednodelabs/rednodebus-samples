## CMakeLists.txt
```
# SPDX-License-Identifier: Apache-2.0

cmake_minimum_required(VERSION 3.20.0)
#cmake_minimum_required(VERSION 3.16.0)
find_package(Zephyr REQUIRED HINTS $ENV{ZEPHYR_BASE})
project(external_lib)

list(INSERT OVERLAY_CONFIG 0 ../common/overlay-ot-defaults.conf)

target_sources(app PRIVATE src/main.c)

# Create a wrapper CMake library that our app can link with
#add_compile_definitions(REDNODEBUS_LIB_IMPORT)
#add_library(rnb_nrf_lib STATIC IMPORTED GLOBAL)
#set_target_properties(rnb_nrf_lib PROPERTIES IMPORTED_LOCATION             ${REDNODELABS_DIR}/rnb_static_lib/librnb_nrf_lib.a)
#set_target_properties(rnb_lib PROPERTIES INTERFACE_INCLUDE_DIRECTORIES ${rnb_inc_dir})

#target_link_libraries(app PUBLIC rnb_nrf_lib)
```

## prj.conf
```kconfig
# Enable networking
CONFIG_NETWORKING=y
CONFIG_STDOUT_CONSOLE=y
```

## overlay-rednodebus.conf
```kconfig
# CONFIG_BT=n

# Disable TCP and IPv4 (TCP disabled to avoid heavy traffic)
CONFIG_NET_TCP=n
CONFIG_NET_IPV4=n

CONFIG_NET_CONFIG_NEED_IPV6=y
CONFIG_NET_CONFIG_NEED_IPV4=n
CONFIG_NET_CONFIG_MY_IPV4_ADDR=""
CONFIG_NET_CONFIG_PEER_IPV4_ADDR=""

CONFIG_NET_L2_OPENTHREAD=y
# CONFIG_NET_L2_IEEE802154_SHELL=y
# CONFIG_NET_L2_IEEE802154_LOG_LEVEL_INF=y

# CONFIG_NET_CONFIG_IEEE802154_CHANNEL=26


# RedNodeBus specific
# CONFIG_PM=y
# CONFIG_PM_DEVICE=y

# CONFIG_WATCHDOG=y
# CONFIG_WDT_DISABLE_AT_BOOT=n

# CONFIG_TEST_RANDOM_GENERATOR=n
# CONFIG_XOROSHIRO_RANDOM_GENERATOR=y

# CONFIG_NET_LOG=n
# CONFIG_NET_L2_IEEE802154_LOG_LEVEL_ERR=y

CONFIG_REDNODEBUS=y
CONFIG_REDNODERANGING=y
CONFIG_REDNODEBUS_RELEASE_STATIC_LIB=y
# >> OT
#CONFIG_NET_L2_IEEE802154=n
#CONFIG_REDNODEBUS_EMPTY_PAYLOAD=n
#CONFIG_REDNODEBUS_REDNODERANGING_MAX_REPORTER_COUNT=2
# <<
# CONFIG_REDNODEBUS_ROLE=0
CONFIG_REDNODEBUS_COMMISSIONING=n
# CONFIG_REDNODEBUS_ANCHOR_SLOT_COUNT=6
# CONFIG_REDNODEBUS_TAG_SLOT_COUNT=2
# CONFIG_REDNODEBUS_DRIVER_LOG_LEVEL_ERR=y

# CONFIG_LOG_STRDUP_MAX_STRING=3072
# CONFIG_LOG_STRDUP_BUF_COUNT=16
# CONFIG_LOG_PROCESS_TRIGGER_THRESHOLD=0
# CONFIG_LOG_PROCESS_THREAD_SLEEP_MS=0

# CONFIG_SHELL_ARGC_MAX=16

# CONFIG_USE_SEGGER_RTT=n
# CONFIG_LOG_BACKEND_RTT=n
# CONFIG_LOG_BACKEND_UART=n

# CONFIG_SHELL_LOG_BACKEND=y
# CONFIG_SHELL_BACKEND_SERIAL=y
# CONFIG_SHELL_BACKEND_RTT=n
# CONFIG_SHELL_BACKEND_SERIAL_RX_RING_BUFFER_SIZE=128
```

## src/main.c
```c
/*
 * Copyright (c) 2017 Intel Corporation
 *
 * SPDX-License-Identifier: Apache-2.0
 */

/* hello world example: calling functions from a static library */


#include <zephyr.h>
#include <stdio.h>

// #include <mylib.h>
#include <net/rednodebus.h>

void main(void)
{
	printf("Hello World!\n");
	// mylib_hello_world();
}
```
