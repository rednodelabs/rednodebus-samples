## CMakeLists.txt
```
# SPDX-License-Identifier: Apache-2.0

cmake_minimum_required(VERSION 3.20.0)

list(APPEND DTS_ROOT ${CMAKE_CURRENT_SOURCE_DIR}/../..)
list(APPEND BOARD_ROOT ${CMAKE_CURRENT_SOURCE_DIR}/../..)

string(REPLACE " " ";" OVERLAY_CONFIG_LIST "${OVERLAY_CONFIG}")
if("overlay-ot-rnb.conf" IN_LIST OVERLAY_CONFIG_LIST)
  include(${CMAKE_CURRENT_SOURCE_DIR}/../common/CMakeLists.txt)
endif()

find_package(Zephyr REQUIRED HINTS $ENV{ZEPHYR_BASE})

project(socket_test)

target_sources(app PRIVATE src/socket-test.c)

target_include_directories(app PUBLIC ${CMAKE_CURRENT_SOURCE_DIR}/../../include)

target_sources_ifdef(CONFIG_NET_UDP app PRIVATE src/udp.c)
target_sources_ifdef(CONFIG_USE_REDNODEBUS_USER_PAYLOAD app PRIVATE src/rnb-user-payload.c)
target_include_directories_ifdef(CONFIG_REDNODEBUS app PUBLIC
  ${CMAKE_CURRENT_SOURCE_DIR}/../common/src)
target_sources_ifdef(CONFIG_REDNODEBUS app PRIVATE
  ${CMAKE_CURRENT_SOURCE_DIR}/../common/src/rnb_utils.c
  ${CMAKE_CURRENT_SOURCE_DIR}/../common/src/rnb_leds.c
  ${CMAKE_CURRENT_SOURCE_DIR}/../common/src/rnb_pa_lna.c)
target_sources_ifdef(CONFIG_REDNODERANGING app PRIVATE
  ${CMAKE_CURRENT_SOURCE_DIR}/../common/src/rnb_ranging_port.c
  ${CMAKE_CURRENT_SOURCE_DIR}/../common/src/rnb_ranging_spi.c
  ${CMAKE_CURRENT_SOURCE_DIR}/../common/src/rnb_ranging_sleep.c)
```

## Kconfig
```
# Copyright (c) 2025 RedNodeLabs
# SPDX-License-Identifier: Apache-2.0

menu "echo_client"

config USE_REDNODEBUS_USER_PAYLOAD
	bool "Enable data traffic through RedNodeBus user payload mechanism"
	default n

config USE_REDNODEBUS_USER_PAYLOAD_ONLY
	bool "Enable data traffic only through RedNodeBus user payload mechanism"
	default n

source "Kconfig.zephyr"

endmenu
```

## sample.yaml
```
sample:
  name: Socket Test
  description: Test transmission performance of UDP client
tests:
  sample.socket_test.rnb:
    platform_allow: nrf52832_mdk nrf52840dk_nrf52840 nrf52833dk_nrf52833 nrf52840dongle_nrf52840 decawave_dwm1001_dev insightsip_isp3010_dev qorvo_dwm3001c_dev rnl_w1 rnl_w1x fanstel_bu840xe
    integration_platforms:
      - nrf52840dk_nrf52840
      - decawave_dwm1001_dev
      - qorvo_dwm3001c_dev
      - rnl_w1
      - rnl_w1x
    extra_args: OVERLAY_CONFIG=overlay-ot-rnb.conf
    build_only: true
    tags: ci_build
  sample.socket_test.rnb.debug:
    platform_allow: nrf52832_mdk nrf52840dk_nrf52840 nrf52833dk_nrf52833 nrf52840dongle_nrf52840 decawave_dwm1001_dev insightsip_isp3010_dev qorvo_dwm3001c_dev rnl_w1 rnl_w1x fanstel_bu840xe
    integration_platforms:
      - nrf52832_mdk
      - nrf52833dk_nrf52833
      - nrf52840dk_nrf52840
      - decawave_dwm1001_dev
      - qorvo_dwm3001c_dev
    extra_args: OVERLAY_CONFIG=overlay-ot-rnb.conf;overlay-debug.conf
    build_only: true
    tags: ci_build
  sample.socket_test.rnb.rnb_user_payload:
    platform_allow: nrf52832_mdk nrf52840dk_nrf52840 nrf52833dk_nrf52833 nrf52840dongle_nrf52840 decawave_dwm1001_dev insightsip_isp3010_dev qorvo_dwm3001c_dev rnl_w1 rnl_w1x fanstel_bu840xe
    integration_platforms:
      - nrf52832_mdk
      - nrf52833dk_nrf52833
      - nrf52840dk_nrf52840
      - decawave_dwm1001_dev
      - qorvo_dwm3001c_dev
    extra_args: OVERLAY_CONFIG=overlay-ot-rnb.conf;overlay-rnb-user-payload.conf
    build_only: true
    tags: ci_build
```

## prj.conf
```kconfig
CONFIG_NET_TC_THREAD_PREEMPTIVE=y

# Generic networking options
CONFIG_NETWORKING=y
CONFIG_NET_UDP=y
CONFIG_NET_TCP=y
CONFIG_NET_IPV6=y
CONFIG_NET_IPV4=y
CONFIG_NET_SOCKETS=y
CONFIG_NET_SOCKETS_POSIX_NAMES=y
CONFIG_NET_SOCKETS_POLL_MAX=4
CONFIG_NET_CONNECTION_MANAGER=y

# Kernel options
CONFIG_ENTROPY_GENERATOR=y
CONFIG_TEST_RANDOM_GENERATOR=y
CONFIG_INIT_STACKS=y

# Logging
CONFIG_NET_LOG=y
CONFIG_LOG=y
CONFIG_NET_STATISTICS=n
CONFIG_PRINTK=y

# Network buffers
CONFIG_NET_PKT_RX_COUNT=16
CONFIG_NET_PKT_TX_COUNT=16
CONFIG_NET_BUF_RX_COUNT=80
CONFIG_NET_BUF_TX_COUNT=80
CONFIG_NET_CONTEXT_NET_PKT_POOL=n

# IP address options
CONFIG_NET_IF_UNICAST_IPV6_ADDR_COUNT=6
CONFIG_NET_IF_MCAST_IPV6_ADDR_COUNT=8
CONFIG_NET_MAX_CONTEXTS=10

# Network shell
CONFIG_NET_SHELL=y

# The addresses are selected so that qemu<->qemu connectivity works ok.
# For linux<->qemu connectivity, create a new conf file and swap the
# addresses (so that peer address is ending to 2).
CONFIG_NET_CONFIG_SETTINGS=n
CONFIG_NET_CONFIG_NEED_IPV6=y
#CONFIG_NET_CONFIG_MY_IPV6_ADDR="2001:db8::2"
#CONFIG_NET_CONFIG_PEER_IPV6_ADDR="2001:0db8:0001:ffff:0000:0000:ac11:0001"
CONFIG_NET_CONFIG_NEED_IPV4=y
#CONFIG_NET_CONFIG_MY_IPV4_ADDR="192.0.2.2"
#CONFIG_NET_CONFIG_PEER_IPV4_ADDR="192.0.2.1"
```

## overlay-debug.conf
```kconfig
#
# Copyright (c) 2022 RedNodeLabs
#

CONFIG_USE_SEGGER_RTT=y
CONFIG_LOG_BACKEND_RTT=y

CONFIG_LOG=y
CONFIG_NET_LOG=y
CONFIG_SHELL=n
CONFIG_OPENTHREAD_SHELL=n
CONFIG_SHELL_BACKEND_SERIAL=n
CONFIG_SHELL_LOG_BACKEND=n
CONFIG_NET_SHELL=n
CONFIG_THREAD_NAME=y
CONFIG_ASSERT=y

CONFIG_REDNODEBUS_DRIVER_LOG_LEVEL_WRN=y
CONFIG_REDNODERANGING_DRIVER_LOG_LEVEL_WRN=y

CONFIG_OPENTHREAD_DEBUG=y
CONFIG_OPENTHREAD_L2_DEBUG=y
CONFIG_OPENTHREAD_LOG_LEVEL_INFO=y
# CONFIG_OPENTHREAD_LOG_LEVEL_DEBG=y
CONFIG_OPENTHREAD_L2_LOG_LEVEL_INF=y
# CONFIG_OPENTHREAD_L2_LOG_LEVEL_DBG=y

# Enable diagnostic module, uncomment if needed
#CONFIG_OPENTHREAD_DIAG=y
```

## overlay-ot-rnb.conf
```kconfig
#
# Copyright (c) 2022 RedNodeLabs
#

CONFIG_NEWLIB_LIBC=y

# Disable TCP and IPv4 (TCP disabled to avoid heavy traffic)
CONFIG_NET_TCP=n
CONFIG_NET_IPV4=n

CONFIG_NET_IPV6_NBR_CACHE=n
CONFIG_NET_IPV6_MLD=n
CONFIG_NET_CONFIG_NEED_IPV4=n
CONFIG_NET_CONFIG_MY_IPV4_ADDR=""
CONFIG_NET_CONFIG_PEER_IPV4_ADDR=""

CONFIG_SYSTEM_WORKQUEUE_STACK_SIZE=2048
CONFIG_SYSTEM_WORKQUEUE_PRIORITY=1
CONFIG_MAIN_STACK_SIZE=2048

CONFIG_NET_L2_OPENTHREAD=y

#CONFIG_OPENTHREAD_DEBUG=y
#CONFIG_OPENTHREAD_L2_DEBUG=y
#CONFIG_OPENTHREAD_L2_LOG_LEVEL_INF=y

CONFIG_SHELL=n
CONFIG_NET_SHELL=n
CONFIG_NET_MGMT=n
CONFIG_NET_STATISTICS=n
CONFIG_CONSOLE=n
CONFIG_SERIAL=n
CONFIG_USE_SEGGER_RTT=n
CONFIG_FLASH_SHELL=n
CONFIG_OPENTHREAD_MTD=y
CONFIG_OPENTHREAD_SLAAC=y

# Network buffers
CONFIG_OPENTHREAD_NUM_MESSAGE_BUFFERS=32
CONFIG_NET_PKT_RX_COUNT=4
CONFIG_NET_PKT_TX_COUNT=4
CONFIG_NET_BUF_RX_COUNT=16
CONFIG_NET_BUF_TX_COUNT=16
```

## boards/nrf52840dk_nrf52840.overlay
```dts
/* Copyright (c) 2022 RedNodeLabs.
 *
 */

/ {
	aliases {
		rnb-tx-led = &led0;
		rnb-rx-led = &led1;
	};
};
```

## boards/rnl_w1x.overlay
```dts
/* Copyright (c) 2023 RedNodeLabs.
 *
 */

/ {
	aliases {
		rnb-tx-led = &led0_red;
		rnb-rx-led = &led1_green;
	};
};
```

## src/common.h
```c
/*
 * Copyright (c) 2017 Intel Corporation.
 * Copyright (c) 2018 Nordic Semiconductor ASA.
 *
 * SPDX-License-Identifier: Apache-2.0
 */
#include <net/ieee802154_radio.h>

/* Value of 0 will cause the IP stack to select next free port */
#define MY_PORT 0

#define PEER_PORT 4242

#if IS_ENABLED(CONFIG_NET_TC_THREAD_PREEMPTIVE)
#define THREAD_PRIORITY K_PRIO_PREEMPT(8)
#else
#define THREAD_PRIORITY K_PRIO_COOP(CONFIG_NUM_COOP_PRIORITIES - 1)
#endif

#define UDP_TRANSMISSION_PERIOD_MSEC 60000
#define UDP_TRANSMISSION_PERIOD_TAG_MSEC 1000
#define UDP_TRANSMISSION_BYTES 40

#define UID_CHARS 12
#define SESSION_RAND_CHARS 4

struct data
{
	const char *proto;

	struct
	{
		int sock;
		uint32_t transmitting;
		uint32_t mtu;
	} udp;
};
struct data_rnb {
	const char *proto;

	struct {
		struct rednodebus_user_payload_params rnb_user_payload_params;
		uint32_t transmitting;
		uint32_t mtu;
	} rnb_user_payload;
};

struct configs
{
	struct data ipv6;
};
struct configs_rnb {
	struct data_rnb rnb;
};

#if !defined(CONFIG_NET_CONFIG_PEER_IPV6_ADDR)
#define CONFIG_NET_CONFIG_PEER_IPV6_ADDR "2001:0db8:0001:ffff:0000:0000:ac11:0001"
#endif

extern char lorem_ipsum[];
extern const int ipsum_len;
extern struct configs conf;

int start_udp(void);
void stop_udp(void);
int send_udp_data(struct data *data);

int start_rnb_user_payload(void);
void stop_rnb_user_payload(void);
int send_rnb_data(struct data_rnb *data);
```

## src/rnb-user-payload.c
```c
/* rnb-user-payload.c - RedNodeBus payload */

/*
 * Copyright (c) 2025 RedNodeLabs.
 *
 * SPDX-License-Identifier: Apache-2.0
 */

#include <logging/log.h>
LOG_MODULE_DECLARE(net_socket_test_sample, LOG_LEVEL_DBG);

#include <zephyr.h>
#include <errno.h>
#include <stdio.h>

#include <net/ieee802154_radio.h>

#include "common.h"

/* Convenience defines for RADIO */
#define REDNODEBUS_API(dev) ((const struct ieee802154_radio_api *const)(dev)->api)

int send_rnb_data(struct data_rnb *data)
{
	const struct device *dev = device_get_binding(CONFIG_IEEE802154_NRF5_DRV_NAME);
	int ret;

	if(data->rnb_user_payload.transmitting == 0 || data->rnb_user_payload.transmitting > data->rnb_user_payload.mtu)
	{
		LOG_ERR("%s USER PAYLOAD: Invalid data size %d", data->proto, data->rnb_user_payload.transmitting);
		ret = -EINVAL;
		goto exit;
	}

	ret = REDNODEBUS_API(dev)->send_rnb_user_payload(dev, &data->rnb_user_payload.rnb_user_payload_params, data->rnb_user_payload.transmitting);

	if (ret == 0)
	{
		LOG_DBG("%s USER PAYLOAD: Sent %d bytes", data->proto, data->rnb_user_payload.transmitting);
		LOG_HEXDUMP_DBG(&data->rnb_user_payload.rnb_user_payload_params.user_payload, data->rnb_user_payload.transmitting, "Data");
	}
	else
	{
		LOG_ERR("%s USER PAYLOAD: error sending %d", data->proto, ret);
	}

exit:
	return ret < 0 ? -EIO : 0;
}

int start_rnb_user_payload(void)
{
	return 0;
}

void stop_rnb_user_payload(void)
{
}
```

## src/socket-test.c
```c
/* socket-test.c - Networking UDP socket client */

/*
 * Copyright (c) 2022 RedNodeLabs UG.
 *
 * SPDX-License-Identifier: Apache-2.0
 */

/*
 * The socket-test application is acting as a client that is run in Zephyr OS,
 * and the server is run in the host acting as a server.
 */

#include <logging/log.h>
LOG_MODULE_REGISTER(net_socket_test_sample, LOG_LEVEL_DBG);

#include <zephyr.h>
#include <errno.h>
#include <stdio.h>

#include <syscalls/rand32.h>
#include <net/socket.h>
#include <net/net_mgmt.h>
#include <net/net_event.h>
#include <net/net_conn_mgr.h>
#include <net/ieee802154_radio.h>

#ifdef CONFIG_REDNODEBUS
#include "rnb_utils.h"
#endif /* CONFIG_REDNODEBUS */

#include "common.h"

#define INVALID_SOCK (-1)

#define EVENT_MASK (NET_EVENT_L4_CONNECTED | \
		    NET_EVENT_L4_DISCONNECTED)

#define MTU_SIZE 1280

static uint8_t rnb_role;

void rnb_utils_handle_new_state(const struct rednodebus_user_event_params_state *state)
{
	rnb_role = state->role;
}

/* Generated by http://www.lipsum.com/
 * 2 paragraphs, 179 words, 1160 bytes of Lorem Ipsum
 */
char lorem_ipsum[] =
    "Lorem ipsum dolor sit amet, consectetur adipiscing elit. Quisque "
    "sodales lorem lorem, sed congue enim vehicula a. Sed finibus diam sed "
    "odio ultrices pharetra. Nullam dictum arcu ultricies turpis congue, "
    "vel venenatis turpis venenatis. Nam tempus arcu eros, ac congue libero "
    "tristique congue. Proin velit lectus, euismod sit amet quam in, "
    "maximus condimentum urna. Cras vel erat luctus, mattis orci ut, varius "
    "urna. Nam eu lobortis velit."
    "\n"
    "Nullam sit amet diam vel odio sodales cursus vehicula eu arcu. Proin "
    "fringilla, enim nec consectetur mollis, lorem orci interdum nisi, "
    "vitae suscipit nisi mauris eu mi. Proin diam enim, mollis ac rhoncus "
    "vitae, placerat et eros. Suspendisse convallis, ipsum nec rhoncus "
    "aliquam, ex augue ultrices nisl, id aliquet mi diam quis ante. "
    "Pellentesque venenatis ornare ultrices. Quisque et porttitor lectus. "
    "Ut venenatis nunc et urna imperdiet porttitor non laoreet massa. Donec "
    "eleifend eros in mi sagittis egestas. Sed et mi nunc. Nunc vulputate, "
    "mauris non ullamcorper viverra, lorem nulla vulputate diam, et congue "
    "dui velit non erat. Duis interdum leo et ipsum tempor consequat. In "
    "faucibus enim quis purus vulputate nullam."
    "\n";

const int ipsum_len = sizeof(lorem_ipsum) - 1;

#if !defined(CONFIG_USE_REDNODEBUS_USER_PAYLOAD_ONLY)
struct configs conf = {
    .ipv6 = {
	.proto = "IPv6",
	.udp.sock = INVALID_SOCK},
};

static struct k_thread udp_thread;
static K_KERNEL_STACK_MEMBER(udp_stack, 800);
#endif

#if defined(CONFIG_USE_REDNODEBUS_USER_PAYLOAD)
struct configs_rnb conf_rnb = {
	.rnb = {
		.proto = "RNB",
		.rnb_user_payload.mtu = REDNODEBUS_USER_PAYLOAD_MAX_LENGTH,
	}
};

static struct k_thread rnb_thread;
static K_KERNEL_STACK_MEMBER(rnb_stack, 800);
#endif

#if !defined(CONFIG_USE_REDNODEBUS_USER_PAYLOAD_ONLY)
static void init_app(void)
{
	conf.ipv6.udp.mtu = MTU_SIZE;

#if defined(CONFIG_REDNODEBUS)
	uint64_t euid = 0;
	rnb_utils_get_euid(&euid);

	sprintf(lorem_ipsum, "%04X%04X", (uint32_t)(euid >> 32), (uint32_t)euid);

	int session_rand = sys_rand32_get();
	memcpy(&lorem_ipsum[UID_CHARS], &session_rand, sizeof(session_rand));
#endif
}

static int start_client(void)
{
	int iterations = 0;
	int i = 0;
 	int ret, rc;
	static int packets_sent = 0;

	while (iterations == 0 || i < iterations)
	{
		ret = start_udp();

		while (ret == 0)
		{
			memcpy(&lorem_ipsum[UID_CHARS + SESSION_RAND_CHARS], &packets_sent, sizeof(packets_sent));
			rc = send_udp_data(&conf.ipv6);
			if(rc < 0)
			{
				LOG_ERR("Failed to send data");
			}
			else
			{
				packets_sent++;
			}

			if (iterations > 0)
			{
				i++;
				if (i >= iterations)
				{
					break;
				}
			}
			if (rnb_role == REDNODEBUS_USER_ROLE_TAG)
			{
				k_sleep(K_MSEC(UDP_TRANSMISSION_PERIOD_TAG_MSEC));
			}
			else
			{
				k_sleep(K_MSEC(UDP_TRANSMISSION_PERIOD_MSEC));
			}
		}
		stop_udp();
	}
	return ret;
}

static void socket_test_udp_thread(void *arg1, void *arg2, void *arg3)
{
	init_app();

	exit(start_client());
}
#endif

#if defined(CONFIG_USE_REDNODEBUS_USER_PAYLOAD)
static void init_app_rnb(void)
{
#if defined(CONFIG_REDNODEBUS)
	uint64_t euid = 0;
	rnb_utils_get_euid(&euid);

	sprintf(lorem_ipsum, "%04X%04X", (uint32_t)(euid >> 32), (uint32_t)euid);

	int session_rand = sys_rand32_get();
	memcpy(&lorem_ipsum[UID_CHARS], &session_rand, sizeof(session_rand));
#endif
}

static int start_client_rnb(void)
{
	int iterations = 0;
	int i = 0;
	int ret, rc;
	static int packets_sent = 0;

	while (iterations == 0 || i < iterations)
	{
		ret = start_rnb_user_payload();

		while (ret == 0)
		{
			memcpy(&lorem_ipsum[UID_CHARS + SESSION_RAND_CHARS], &packets_sent, sizeof(packets_sent));
			conf_rnb.rnb.rnb_user_payload.transmitting = UDP_TRANSMISSION_BYTES % ipsum_len;
			memcpy(&conf_rnb.rnb.rnb_user_payload.rnb_user_payload_params.user_payload, lorem_ipsum, conf_rnb.rnb.rnb_user_payload.transmitting);
			rc = send_rnb_data(&conf_rnb.rnb);
			if(rc < 0)
			{
				LOG_ERR("Failed to send data");
			}
			else
			{
				packets_sent++;
			}

			if (iterations > 0)
			{
				i++;
				if (i >= iterations)
				{
					break;
				}
			}
			if (rnb_role == REDNODEBUS_USER_ROLE_TAG)
			{
				k_sleep(K_MSEC(UDP_TRANSMISSION_PERIOD_TAG_MSEC));
			}
			else
			{
				k_sleep(K_MSEC(UDP_TRANSMISSION_PERIOD_MSEC));
			}
		}
		stop_rnb_user_payload();
	}
	return ret;
}

static void socket_test_rnb_thread(void *arg1, void *arg2, void *arg3)
{
	init_app_rnb();

	exit(start_client_rnb());
}
#endif

void main(void)
{
#ifdef CONFIG_REDNODEBUS
	init_rnb();

	while (!is_rnb_connected())
	{
		k_sleep(K_MSEC(1000));
	}
#endif /* CONFIG_REDNODEBUS */

#if !defined(CONFIG_USE_REDNODEBUS_USER_PAYLOAD_ONLY)
	k_thread_create(&udp_thread,
			udp_stack,
			K_THREAD_STACK_SIZEOF(udp_stack),
			socket_test_udp_thread,
			NULL,
			NULL,
			NULL,
			K_PRIO_PREEMPT(7),
			0,
			K_NO_WAIT);
#endif
#if defined(CONFIG_USE_REDNODEBUS_USER_PAYLOAD)
	k_thread_create(&rnb_thread,
			rnb_stack,
			K_THREAD_STACK_SIZEOF(rnb_stack),
			socket_test_rnb_thread,
			NULL,
			NULL,
			NULL,
			K_PRIO_PREEMPT(7),
			0,
			K_NO_WAIT);
#endif
}
```

## src/udp.c
```c
/* udp.c - UDP specific code for echo client */

/*
 * Copyright (c) 2017 Intel Corporation.
 * Copyright (c) 2018 Nordic Semiconductor ASA.
 *
 * SPDX-License-Identifier: Apache-2.0
 */

#include <logging/log.h>
LOG_MODULE_DECLARE(net_socket_test_sample, LOG_LEVEL_DBG);

#include <zephyr.h>
#include <errno.h>
#include <stdio.h>

#include <net/socket.h>
#include <net/tls_credentials.h>
#include <random/rand32.h>

#include "common.h"

int send_udp_data(struct data *data)
{
	int ret;

	data->udp.transmitting = UDP_TRANSMISSION_BYTES % ipsum_len;

	ret = send(data->udp.sock, lorem_ipsum, data->udp.transmitting, 0);

	LOG_DBG("%s UDP: Sent %d bytes", data->proto, data->udp.transmitting);

	return ret < 0 ? -EIO : 0;
}

static int start_udp_proto(struct data *data, struct sockaddr *addr,
			   socklen_t addrlen)
{
	int ret;

	data->udp.sock = socket(addr->sa_family, SOCK_DGRAM, IPPROTO_UDP);

	if (data->udp.sock < 0)
	{
		LOG_ERR("Failed to create UDP socket (%s): %d", data->proto,
			errno);
		return -errno;
	}

	/* Call connect so we can use send and recv. */
	ret = connect(data->udp.sock, addr, addrlen);
	if (ret < 0)
	{
		LOG_ERR("Cannot connect to UDP remote (%s): %d", data->proto,
			errno);
		ret = -errno;
	}

	return ret;
}

int start_udp(void)
{
	int ret = 0;
	struct sockaddr_in6 addr6;

	if (IS_ENABLED(CONFIG_NET_IPV6))
	{
		addr6.sin6_family = AF_INET6;
		addr6.sin6_port = htons(PEER_PORT);
		inet_pton(AF_INET6, CONFIG_NET_CONFIG_PEER_IPV6_ADDR,
			  &addr6.sin6_addr);

		ret = start_udp_proto(&conf.ipv6, (struct sockaddr *)&addr6,
				      sizeof(addr6));
		if (ret < 0)
		{
			return ret;
		}
	}

	return ret;
}

void stop_udp(void)
{
	if (IS_ENABLED(CONFIG_NET_IPV6))
	{
		if (conf.ipv6.udp.sock >= 0)
		{
			(void)close(conf.ipv6.udp.sock);
		}
	}
}
```
