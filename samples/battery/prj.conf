## CMakeLists.txt
```
# SPDX-License-Identifier: Apache-2.0

cmake_minimum_required(VERSION 3.20.0)

list(APPEND DTS_ROOT ${CMAKE_CURRENT_SOURCE_DIR}/../..)
list(APPEND BOARD_ROOT ${CMAKE_CURRENT_SOURCE_DIR}/../..)

string(REPLACE " " ";" OVERLAY_CONFIG_LIST "${OVERLAY_CONFIG}")
if("overlay-ot-rnb.conf" IN_LIST OVERLAY_CONFIG_LIST)
  include(${CMAKE_CURRENT_SOURCE_DIR}/../common/CMakeLists.txt)
endif()

find_package(Zephyr REQUIRED HINTS $ENV{ZEPHYR_BASE})

project(battery)

target_sources(app PRIVATE src/main.c src/battery.c)

target_include_directories(app PUBLIC ${CMAKE_CURRENT_SOURCE_DIR}/../../include)

target_sources_ifdef(CONFIG_NET_UDP app PRIVATE src/udp.c)

target_include_directories_ifdef(CONFIG_REDNODEBUS app PUBLIC ../common/src)
target_sources_ifdef(CONFIG_REDNODEBUS app PRIVATE
  ${CMAKE_CURRENT_SOURCE_DIR}/../common/src/rnb_utils.c
  ${CMAKE_CURRENT_SOURCE_DIR}/../common/src/rnb_leds.c
  ${CMAKE_CURRENT_SOURCE_DIR}/../common/src/rnb_pa_lna.c)
target_sources_ifdef(CONFIG_REDNODERANGING app PRIVATE
  ${CMAKE_CURRENT_SOURCE_DIR}/../common/src/rnb_ranging_port.c
  ${CMAKE_CURRENT_SOURCE_DIR}/../common/src/rnb_ranging_spi.c
  ${CMAKE_CURRENT_SOURCE_DIR}/../common/src/rnb_ranging_sleep.c)

include(${ZEPHYR_BASE}/samples/net/common/common.cmake)
```

## sample.yaml
```
sample:
  name: Battery
  description: Test sending battery level values using the UDP client
tests:
  sample.battery.rnb:
    platform_allow: rnl_w1 rnl_w1x
    integration_platforms:
      - rnl_w1
      - rnl_w1x
    extra_args: OVERLAY_CONFIG=overlay-ot-rnb.conf
    build_only: true
    tags: ci_build
```

## prj.conf
```kconfig
# Copyright (c) 2024 RedNodeLabs.

# Generic networking options
CONFIG_NETWORKING=y
CONFIG_NET_UDP=y
CONFIG_NET_TCP=y
CONFIG_NET_IPV6=y
CONFIG_NET_IPV4=y
CONFIG_NET_SOCKETS=y
CONFIG_NET_SOCKETS_POSIX_NAMES=y
CONFIG_NET_SOCKETS_POLL_MAX=4
CONFIG_NET_CONNECTION_MANAGER=y

# Kernel options
CONFIG_ENTROPY_GENERATOR=y
CONFIG_TEST_RANDOM_GENERATOR=y
CONFIG_INIT_STACKS=y

# Logging
CONFIG_NET_LOG=y
CONFIG_LOG=y
CONFIG_NET_STATISTICS=n
CONFIG_PRINTK=y

# Network buffers
CONFIG_NET_PKT_RX_COUNT=16
CONFIG_NET_PKT_TX_COUNT=16
CONFIG_NET_BUF_RX_COUNT=80
CONFIG_NET_BUF_TX_COUNT=80
CONFIG_NET_CONTEXT_NET_PKT_POOL=n

# IP address options
CONFIG_NET_IF_UNICAST_IPV6_ADDR_COUNT=6
CONFIG_NET_IF_MCAST_IPV6_ADDR_COUNT=8
CONFIG_NET_MAX_CONTEXTS=10

# Network shell
CONFIG_NET_SHELL=y

# The addresses are selected so that qemu<->qemu connectivity works ok.
# For linux<->qemu connectivity, create a new conf file and swap the
# addresses (so that peer address is ending to 2).
CONFIG_NET_CONFIG_SETTINGS=n
CONFIG_NET_CONFIG_NEED_IPV6=y
#CONFIG_NET_CONFIG_MY_IPV6_ADDR="2001:db8::2"
#CONFIG_NET_CONFIG_PEER_IPV6_ADDR="2001:0db8:0001:ffff:0000:0000:ac11:0001"
CONFIG_NET_CONFIG_NEED_IPV4=y
#CONFIG_NET_CONFIG_MY_IPV4_ADDR="192.0.2.2"
#CONFIG_NET_CONFIG_PEER_IPV4_ADDR="192.0.2.1"

CONFIG_ADC=y
```

## overlay-debug.conf
```kconfig
#
# Copyright (c) 2022 RedNodeLabs
#

CONFIG_USE_SEGGER_RTT=y
CONFIG_LOG_BACKEND_RTT=y

CONFIG_LOG=y
CONFIG_NET_LOG=y
CONFIG_SHELL=n
CONFIG_OPENTHREAD_SHELL=n
CONFIG_SHELL_BACKEND_SERIAL=n
CONFIG_SHELL_LOG_BACKEND=n
CONFIG_NET_SHELL=n
CONFIG_THREAD_NAME=y

CONFIG_REDNODEBUS_DRIVER_LOG_LEVEL_WRN=y

CONFIG_OPENTHREAD_DEBUG=y
CONFIG_OPENTHREAD_L2_DEBUG=y
CONFIG_OPENTHREAD_LOG_LEVEL_INFO=y
# CONFIG_OPENTHREAD_LOG_LEVEL_DEBG=y
CONFIG_OPENTHREAD_L2_LOG_LEVEL_INF=y
# CONFIG_OPENTHREAD_L2_LOG_LEVEL_DBG=y

# Enable diagnostic module, uncomment if needed
#CONFIG_OPENTHREAD_DIAG=y
```

## overlay-ot-rnb.conf
```kconfig
#
# Copyright (c) 2022 RedNodeLabs
#

CONFIG_NEWLIB_LIBC=y

# Disable TCP and IPv4 (TCP disabled to avoid heavy traffic)
CONFIG_NET_TCP=n
CONFIG_NET_IPV4=n

CONFIG_NET_IPV6_NBR_CACHE=n
CONFIG_NET_IPV6_MLD=n
CONFIG_NET_CONFIG_NEED_IPV4=n
CONFIG_NET_CONFIG_MY_IPV4_ADDR=""
CONFIG_NET_CONFIG_PEER_IPV4_ADDR=""

CONFIG_SYSTEM_WORKQUEUE_STACK_SIZE=2048
CONFIG_SYSTEM_WORKQUEUE_PRIORITY=1
CONFIG_MAIN_STACK_SIZE=2048

CONFIG_NET_L2_OPENTHREAD=y

#CONFIG_OPENTHREAD_DEBUG=y
#CONFIG_OPENTHREAD_L2_DEBUG=y
#∫CONFIG_OPENTHREAD_L2_LOG_LEVEL_INF=y

CONFIG_SHELL=n
CONFIG_NET_SHELL=n
CONFIG_NET_MGMT=n
CONFIG_NET_STATISTICS=n
CONFIG_CONSOLE=n
CONFIG_SERIAL=n
CONFIG_USE_SEGGER_RTT=n
CONFIG_FLASH_SHELL=n
CONFIG_OPENTHREAD_MTD=y
CONFIG_OPENTHREAD_SLAAC=y

# Network buffers
CONFIG_OPENTHREAD_NUM_MESSAGE_BUFFERS=32
CONFIG_NET_PKT_RX_COUNT=4
CONFIG_NET_PKT_TX_COUNT=4
CONFIG_NET_BUF_RX_COUNT=16
CONFIG_NET_BUF_TX_COUNT=16
```

## src/main.c
```c
/* socket-test.c - Networking battery UDP socket client */

/*
 * Copyright (c) 2022 RedNodeLabs UG.
 *
 * SPDX-License-Identifier: Apache-2.0
 */

/*
 * The battery application is acting as a client that is run in Zephyr OS,
 * and the server is run in the host acting as a server.
 */

#include <logging/log.h>
LOG_MODULE_REGISTER(net_battery_sample, LOG_LEVEL_DBG);

#include <zephyr.h>
#include <errno.h>
#include <stdio.h>

#include <syscalls/rand32.h>
#include <net/socket.h>
#include <net/net_mgmt.h>
#include <net/net_event.h>
#include <net/net_conn_mgr.h>
#include <net/ieee802154_radio.h>

#include <device.h>
#include <drivers/sensor.h>

#include "battery.h"

#if defined(CONFIG_REDNODEBUS)
#include "rnb_utils.h"
#endif

#include "common.h"

#define INVALID_SOCK (-1)

#define EVENT_MASK (NET_EVENT_L4_CONNECTED | \
		    NET_EVENT_L4_DISCONNECTED)

#define MTU_SIZE 1280

static uint8_t rnb_role;
int32_t packet_buffer[5];
const int packet_len = sizeof(packet_buffer);

const struct device *sensor;

struct configs conf = {
    .ipv6 = {
	.proto = "IPv6",
	.udp.sock = INVALID_SOCK},
};

#if defined(CONFIG_REDNODEBUS)
void rnb_utils_handle_new_state(const struct rednodebus_user_event_params_state *state)
{
	rnb_role = state->role;
}
#endif

static void init_app(void)
{
	conf.ipv6.udp.mtu = MTU_SIZE;

#if defined(CONFIG_REDNODEBUS)
	uint64_t euid = 0;
	rnb_utils_get_euid(&euid);

	packet_buffer[0] = (uint32_t)euid;
	packet_buffer[1] = (uint32_t)(euid >> 32);

	int session_rand = sys_rand32_get();
	packet_buffer[2] = session_rand;
#endif
}

static void battery_send_value()
{
	int batt_mV = battery_sample();

	if (batt_mV < 0)
	{
		LOG_ERR("Failed to read battery voltage: %d\n",
			batt_mV);
	}
	else
	{
		LOG_DBG("Battery: : %d mV", batt_mV);

		packet_buffer[4] = batt_mV;

		send_udp_data(&conf.ipv6);
	}
}

static void start_client(void)
{
	int ret;

	ret = start_udp();
	if (ret == 0)
	{
		while (1)
		{
			ret = battery_measure_enable(true);

			if (ret != 0)
			{
				LOG_ERR("Failed initialize battery measurement: %d\n", ret);
				return;
			}

			// Wait until the value at the ADC pin is stable
			k_sleep(K_MSEC(100));

			battery_send_value();
			battery_measure_enable(false);

			k_sleep(K_MSEC(UDP_TRANSMISSION_PERIOD_SECONDS * 1000));
		}
	}
	else
	{
		LOG_ERR("UDP init failed");
		stop_udp();
	}
}

void main(void)
{
	k_thread_priority_set(k_current_get(), THREAD_PRIORITY);

#if defined(CONFIG_REDNODEBUS)
	init_rnb();

	while (!is_rnb_connected())
	{
		k_sleep(K_MSEC(1000));
	}
#endif

	init_app();

	start_client();
}
```

## src/battery.c
```c
/*
 * Copyright (c) 2018-2019 Peter Bigot Consulting, LLC
 * Copyright (c) 2019-2020 Nordic Semiconductor ASA
 *
 * SPDX-License-Identifier: Apache-2.0
 */

#include <math.h>
#include <stdio.h>
#include <stdlib.h>

#include <zephyr/zephyr.h>
#include <zephyr/init.h>
#include <zephyr/drivers/gpio.h>
#include <zephyr/drivers/adc.h>
#include <zephyr/drivers/sensor.h>
#include <zephyr/logging/log.h>

#include "battery.h"

LOG_MODULE_REGISTER(BATTERY, CONFIG_ADC_LOG_LEVEL);

#define VBATT DT_PATH(vbatt)

/* This board uses a divider that reduces max voltage to
 * reference voltage (600 mV).
 */
#define BATTERY_ADC_GAIN ADC_GAIN_1

struct io_channel_config
{
	uint8_t channel;
};

struct divider_config
{
	struct io_channel_config io_channel;
	struct gpio_dt_spec power_gpios;
	/* output_ohm is used as a flag value: if it is nonzero then
	 * the battery is measured through a voltage divider;
	 * otherwise it is assumed to be directly connected to Vdd.
	 */
	uint32_t output_ohm;
	uint32_t full_ohm;
};

static const struct divider_config divider_config = {
    .io_channel = {
	DT_IO_CHANNELS_INPUT(VBATT),
    },
    .power_gpios = GPIO_DT_SPEC_GET_OR(VBATT, power_gpios, {}),
    .output_ohm = DT_PROP(VBATT, output_ohms),
    .full_ohm = DT_PROP(VBATT, full_ohms),
};

struct divider_data
{
	const struct device *adc;
	struct adc_channel_cfg adc_cfg;
	struct adc_sequence adc_seq;
	int16_t raw;
};
static struct divider_data divider_data = {
    .adc = DEVICE_DT_GET(DT_IO_CHANNELS_CTLR(VBATT)),
};

static const struct gpio_dt_spec batt_stat = GPIO_DT_SPEC_GET_OR(DT_ALIAS(battery_stat), gpios, {0});
static const struct gpio_dt_spec pwr_good = GPIO_DT_SPEC_GET_OR(DT_ALIAS(power_good), gpios, {0});
static struct gpio_dt_spec batt_stat_led = GPIO_DT_SPEC_GET_OR(DT_ALIAS(led2_blue), gpios, {0});
static struct gpio_callback batt_stat_cb_data;
static struct gpio_callback pwr_good_cb_data;
static bool battery_ok;

void batt_stat_changed(const struct device *dev, struct gpio_callback *cb, uint32_t pins)
{
	int batt_stat_val = gpio_pin_get_dt(&batt_stat);
	int pwr_good_val = gpio_pin_get_dt(&pwr_good);

	if (batt_stat_led.port && batt_stat_val >= 0 && pwr_good_val >= 0)
	{
		if (pwr_good_val == 0)
		{
			// OFF
			gpio_pin_set_dt(&batt_stat_led, 0);
		}
		else
		{
			gpio_pin_set_dt(&batt_stat_led, batt_stat_val);
		}
	}
}

void pwr_good_changed(const struct device *dev, struct gpio_callback *cb, uint32_t pins)
{
	int val = gpio_pin_get_dt(&pwr_good);

	LOG_INF("power good changed %d", val);
}

static int divider_setup(void)
{
	const struct divider_config *cfg = &divider_config;
	const struct io_channel_config *iocp = &cfg->io_channel;
	const struct gpio_dt_spec *gcp = &cfg->power_gpios;
	struct divider_data *ddp = &divider_data;
	struct adc_sequence *asp = &ddp->adc_seq;
	struct adc_channel_cfg *accp = &ddp->adc_cfg;
	int rc;

	if (!device_is_ready(ddp->adc))
	{
		LOG_ERR("ADC device is not ready %s", ddp->adc->name);
		return -ENOENT;
	}

	if (gcp->port)
	{
		if (!device_is_ready(gcp->port))
		{
			LOG_ERR("%s: device not ready", gcp->port->name);
			return -ENOENT;
		}
		rc = gpio_pin_configure_dt(gcp, GPIO_OUTPUT_INACTIVE);
		if (rc != 0)
		{
			LOG_ERR("Failed to control feed %s.%u: %d",
				gcp->port->name, gcp->pin, rc);
			return rc;
		}
	}

	*asp = (struct adc_sequence){
	    .channels = BIT(0),
	    .buffer = &ddp->raw,
	    .buffer_size = sizeof(ddp->raw),
	    .oversampling = 8,
	    .calibrate = true,
	};

#ifdef CONFIG_ADC_NRFX_SAADC
	*accp = (struct adc_channel_cfg){
	    .gain = BATTERY_ADC_GAIN,
	    .reference = ADC_REF_INTERNAL,
	    .acquisition_time = ADC_ACQ_TIME(ADC_ACQ_TIME_MICROSECONDS, 40),
	};

	if (cfg->output_ohm != 0)
	{
		accp->input_positive = SAADC_CH_PSELP_PSELP_AnalogInput0 + iocp->channel;
	}
	else
	{
		accp->input_positive = SAADC_CH_PSELP_PSELP_VDD;
	}

	asp->resolution = 14;
#else /* CONFIG_ADC_var */
#error Unsupported ADC
#endif /* CONFIG_ADC_var */

	rc = adc_channel_setup(ddp->adc, accp);
	LOG_INF("Setup AIN%u got %d", iocp->channel, rc);

	return rc;
}

static int batt_stat_setup(void)
{
	int ret;

	if (!device_is_ready(batt_stat.port))
	{
		LOG_ERR("Error: BATTERY STAT device %s is not ready\n",
			batt_stat.port->name);
		return -ENOENT;
	}

	ret = gpio_pin_configure_dt(&batt_stat, GPIO_INPUT);
	if (ret != 0)
	{
		LOG_ERR("Error %d: failed to configure %s pin %d\n",
			ret, batt_stat.port->name, batt_stat.pin);
		return -ENOENT;
	}

	ret = gpio_pin_interrupt_configure_dt(&batt_stat, GPIO_INT_EDGE_BOTH);
	if (ret != 0)
	{
		LOG_ERR("Error %d: failed to configure interrupt on %s pin %d\n",
			ret, batt_stat.port->name, batt_stat.pin);
		return ret;
	}

	gpio_init_callback(&batt_stat_cb_data, batt_stat_changed, BIT(batt_stat.pin));
	gpio_add_callback(batt_stat.port, &batt_stat_cb_data);

	if (batt_stat_led.port && !device_is_ready(batt_stat_led.port))
	{
		LOG_ERR("Error %d: BATTERY STAT LED device %s is not ready; ignoring it\n",
			ret, batt_stat_led.port->name);
		batt_stat_led.port = NULL;
	}
	if (batt_stat_led.port)
	{
		ret = gpio_pin_configure_dt(&batt_stat_led, GPIO_OUTPUT);
		if (ret != 0)
		{
			LOG_ERR("Error %d: failed to configure BATTERY STAT LED device %s pin %d\n",
				ret, batt_stat_led.port->name, batt_stat_led.pin);
			batt_stat_led.port = NULL;
		}
		else
		{
			batt_stat_changed(NULL, NULL, 0);

			LOG_INF("Set up BATTERY STAT LED at %s pin %d\n", batt_stat_led.port->name, batt_stat_led.pin);
		}
	}

	return ret;
}

static int pwr_good_setup(void)
{
	int ret;

	if (!device_is_ready(pwr_good.port))
	{
		LOG_ERR("Error: POWER GOOD device %s is not ready\n",
			pwr_good.port->name);
		return -ENOENT;
	}

	ret = gpio_pin_configure_dt(&pwr_good, GPIO_INPUT);
	if (ret != 0)
	{
		LOG_ERR("Error %d: failed to configure %s pin %d\n",
			ret, pwr_good.port->name, pwr_good.pin);
		return -ENOENT;
	}

	ret = gpio_pin_interrupt_configure_dt(&pwr_good, GPIO_INT_EDGE_BOTH);
	if (ret != 0)
	{
		LOG_ERR("Error %d: failed to configure interrupt on %s pin %d\n",
			ret, pwr_good.port->name, pwr_good.pin);
		return ret;
	}

	gpio_init_callback(&pwr_good_cb_data, pwr_good_changed, BIT(pwr_good.pin));
	gpio_add_callback(pwr_good.port, &pwr_good_cb_data);

	return ret;
}

static int battery_setup(const struct device *arg)
{
	int ret = divider_setup();

	battery_ok = (ret == 0);
	LOG_INF("Battery setup: %d %d", ret, battery_ok);

	if (ret != 0)
	{
		return ret;
	}

	ret = pwr_good_setup();

	if (ret != 0)
	{
		return ret;
	}

	ret = batt_stat_setup();

	return ret;
}

SYS_INIT(battery_setup, APPLICATION, CONFIG_APPLICATION_INIT_PRIORITY);

int battery_measure_enable(bool enable)
{
	int rc = -ENOENT;

	if (battery_ok)
	{
		const struct gpio_dt_spec *gcp = &divider_config.power_gpios;

		rc = 0;
		if (gcp->port)
		{
			rc = gpio_pin_set_dt(gcp, enable);
		}
	}
	return rc;
}

int battery_sample(void)
{
	int rc = -ENOENT;

	if (battery_ok)
	{
		struct divider_data *ddp = &divider_data;
		const struct divider_config *dcp = &divider_config;
		struct adc_sequence *sp = &ddp->adc_seq;

		rc = adc_read(ddp->adc, sp);
		sp->calibrate = false;
		if (rc == 0)
		{
			int32_t val = ddp->raw;

			adc_raw_to_millivolts(adc_ref_internal(ddp->adc),
					      ddp->adc_cfg.gain,
					      sp->resolution,
					      &val);

			if (dcp->output_ohm != 0)
			{
				rc = val * (uint64_t)dcp->full_ohm / dcp->output_ohm;
				LOG_INF("raw %u ~ %u mV => %d mV\n",
					ddp->raw, val, rc);
			}
			else
			{
				rc = val;
				LOG_INF("raw %u ~ %u mV\n", ddp->raw, val);
			}
		}
	}

	return rc;
}

unsigned int battery_level_pptt(unsigned int batt_mV,
				const struct battery_level_point *curve)
{
	const struct battery_level_point *pb = curve;

	if (batt_mV >= pb->lvl_mV)
	{
		/* Measured voltage above highest point, cap at maximum. */
		return pb->lvl_pptt;
	}
	/* Go down to the last point at or below the measured voltage. */
	while ((pb->lvl_pptt > 0) && (batt_mV < pb->lvl_mV))
	{
		++pb;
	}
	if (batt_mV < pb->lvl_mV)
	{
		/* Below lowest point, cap at minimum */
		return pb->lvl_pptt;
	}

	/* Linear interpolation between below and above points. */
	const struct battery_level_point *pa = pb - 1;

	return pb->lvl_pptt + ((pa->lvl_pptt - pb->lvl_pptt) * (batt_mV - pb->lvl_mV) / (pa->lvl_mV - pb->lvl_mV));
}
```

## src/battery.h
```c
/*
 * Copyright (c) 2018-2019 Peter Bigot Consulting, LLC
 *
 * SPDX-License-Identifier: Apache-2.0
 */

#ifndef APPLICATION_BATTERY_H_
#define APPLICATION_BATTERY_H_

/** Enable or disable measurement of the battery voltage.
 *
 * @param enable true to enable, false to disable
 *
 * @return zero on success, or a negative error code.
 */
int battery_measure_enable(bool enable);

/** Measure the battery voltage.
 *
 * @return the battery voltage in millivolts, or a negative error
 * code.
 */
int battery_sample(void);

/** A point in a battery discharge curve sequence.
 *
 * A discharge curve is defined as a sequence of these points, where
 * the first point has #lvl_pptt set to 10000 and the last point has
 * #lvl_pptt set to zero.  Both #lvl_pptt and #lvl_mV should be
 * monotonic decreasing within the sequence.
 */
struct battery_level_point
{
	/** Remaining life at #lvl_mV. */
	uint16_t lvl_pptt;

	/** Battery voltage at #lvl_pptt remaining life. */
	uint16_t lvl_mV;
};

/** Calculate the estimated battery level based on a measured voltage.
 *
 * @param batt_mV a measured battery voltage level.
 *
 * @param curve the discharge curve for the type of battery installed
 * on the system.
 *
 * @return the estimated remaining capacity in parts per ten
 * thousand.
 */
unsigned int battery_level_pptt(unsigned int batt_mV,
				const struct battery_level_point *curve);

#endif /* APPLICATION_BATTERY_H_ */
```

## src/common.h
```c
/*
 * Copyright (c) 2017 Intel Corporation.
 * Copyright (c) 2018 Nordic Semiconductor ASA.
 *
 * SPDX-License-Identifier: Apache-2.0
 */

/* Value of 0 will cause the IP stack to select next free port */
#define MY_PORT 0

#define PEER_PORT 4242

#if IS_ENABLED(CONFIG_NET_TC_THREAD_PREEMPTIVE)
#define THREAD_PRIORITY K_PRIO_PREEMPT(8)
#else
#define THREAD_PRIORITY K_PRIO_COOP(CONFIG_NUM_COOP_PRIORITIES - 1)
#endif

struct data
{
	const char *proto;

	struct
	{
		int sock;
		uint32_t transmitting;
		uint32_t mtu;
	} udp;
};

struct configs
{
	struct data ipv6;
};

#if !defined(CONFIG_NET_CONFIG_PEER_IPV6_ADDR)
#define CONFIG_NET_CONFIG_PEER_IPV6_ADDR "2001:0db8:0001:ffff:0000:0000:ac11:0001"
#endif

#define UDP_TRANSMISSION_PERIOD_SECONDS 20

extern int32_t packet_buffer[];
extern const int packet_len;
extern struct configs conf;

int start_udp(void);
void stop_udp(void);
int send_udp_data(struct data *data);
```

## src/udp.c
```c
/* udp.c - UDP specific code for echo client */

/*
 * Copyright (c) 2017 Intel Corporation.
 * Copyright (c) 2018 Nordic Semiconductor ASA.
 *
 * SPDX-License-Identifier: Apache-2.0
 */

#include <logging/log.h>
LOG_MODULE_DECLARE(net_battery_sample, LOG_LEVEL_DBG);

#include <zephyr.h>
#include <errno.h>
#include <stdio.h>

#include <net/socket.h>
#include <net/tls_credentials.h>
#include <random/rand32.h>

#include "common.h"

int send_udp_data(struct data *data)
{
	int ret;
	static int packets_sent;

	packet_buffer[3] = packets_sent;

	do
	{
		data->udp.transmitting = packet_len;
	} while (data->udp.transmitting == 0U ||
		 data->udp.transmitting > data->udp.mtu);

	ret = send(data->udp.sock, packet_buffer, data->udp.transmitting, 0);

	LOG_DBG("%s UDP: Sent %d bytes", data->proto, data->udp.transmitting);

	packets_sent++;

	return ret < 0 ? -EIO : 0;
}

static int start_udp_proto(struct data *data, struct sockaddr *addr,
			   socklen_t addrlen)
{
	int ret;

	data->udp.sock = socket(addr->sa_family, SOCK_DGRAM, IPPROTO_UDP);

	if (data->udp.sock < 0)
	{
		LOG_ERR("Failed to create UDP socket (%s): %d", data->proto,
			errno);
		return -errno;
	}

	/* Call connect so we can use send and recv. */
	ret = connect(data->udp.sock, addr, addrlen);
	if (ret < 0)
	{
		LOG_ERR("Cannot connect to UDP remote (%s): %d", data->proto,
			errno);
		ret = -errno;
	}

	return ret;
}

int start_udp(void)
{
	int ret = 0;
	struct sockaddr_in6 addr6;

	if (IS_ENABLED(CONFIG_NET_IPV6))
	{
		addr6.sin6_family = AF_INET6;
		addr6.sin6_port = htons(PEER_PORT);
		inet_pton(AF_INET6, CONFIG_NET_CONFIG_PEER_IPV6_ADDR,
			  &addr6.sin6_addr);

		ret = start_udp_proto(&conf.ipv6, (struct sockaddr *)&addr6,
				      sizeof(addr6));
		if (ret < 0)
		{
			return ret;
		}
	}

	return ret;
}

void stop_udp(void)
{
	if (IS_ENABLED(CONFIG_NET_IPV6))
	{
		if (conf.ipv6.udp.sock >= 0)
		{
			(void)close(conf.ipv6.udp.sock);
		}
	}
}
```
