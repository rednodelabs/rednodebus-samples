## CMakeLists.txt
```
# SPDX-License-Identifier: Apache-2.0

cmake_minimum_required(VERSION 3.20.0)

list(APPEND DTS_ROOT ${CMAKE_CURRENT_SOURCE_DIR}/../..)
list(APPEND BOARD_ROOT ${CMAKE_CURRENT_SOURCE_DIR}/../..)

string(REPLACE " " ";" OVERLAY_CONFIG_LIST "${OVERLAY_CONFIG}")
if("overlay-ot-rnb.conf" IN_LIST OVERLAY_CONFIG_LIST)
  include(${CMAKE_CURRENT_SOURCE_DIR}/../common/CMakeLists.txt)
endif()

find_package(Zephyr REQUIRED HINTS $ENV{ZEPHYR_BASE})

project(coap_client)

target_sources(app PRIVATE src/coap_client.c
  src/coap_client_utils.c)

target_include_directories(app PUBLIC ${CMAKE_CURRENT_SOURCE_DIR}/../../include)

target_include_directories(app PUBLIC ${CMAKE_CURRENT_SOURCE_DIR}/../coap_server/interface)

target_include_directories_ifdef(CONFIG_REDNODEBUS app PUBLIC
  ${CMAKE_CURRENT_SOURCE_DIR}/../common/src)
target_sources_ifdef(CONFIG_REDNODEBUS app PRIVATE
  ${CMAKE_CURRENT_SOURCE_DIR}/../common/src/rnb_utils.c
  ${CMAKE_CURRENT_SOURCE_DIR}/../common/src/rnb_leds.c)
target_sources_ifdef(CONFIG_REDNODERANGING app PRIVATE
  ${CMAKE_CURRENT_SOURCE_DIR}/../common/src/rnb_ranging_port.c
  ${CMAKE_CURRENT_SOURCE_DIR}/../common/src/rnb_ranging_spi.c
  ${CMAKE_CURRENT_SOURCE_DIR}/../common/src/rnb_ranging_sleep.c)
```

## Kconfig
```
#
# Copyright (c) 2020 Nordic Semiconductor ASA
#
# SPDX-License-Identifier: LicenseRef-Nordic-5-Clause
#

menu "Zephyr Kernel"
source "Kconfig.zephyr"
endmenu

module = COAP_CLIENT
module-str = CoAP client
source "${ZEPHYR_BASE}/subsys/logging/Kconfig.template.log_config"

module = COAP_CLIENT_UTILS
module-str = CoAP client utilities
source "${ZEPHYR_BASE}/subsys/logging/Kconfig.template.log_config"

module = BLE_UTILS
module-str = Bluetooth connection utilities
source "${ZEPHYR_BASE}/subsys/logging/Kconfig.template.log_config"

module = RNB_UTILS
module-str = RedNodeBus
source "${ZEPHYR_BASE}/subsys/logging/Kconfig.template.log_config"
```

## sample.yaml
```
sample:
  name: OpenThread CoAP Client RedNodeBus
  description: Test CoAP communication in Thread RedNodebus network
tests:
  sample.coap_client.rnb:
    platform_allow: nrf52832_mdk nrf52840dk_nrf52840 nrf52833dk_nrf52833 nrf52840dongle_nrf52840 decawave_dwm1001_dev insightsip_isp3010_dev qorvo_dwm3001c_dev rnl_w1 rnl_w1x
    integration_platforms:
      - nrf52832_mdk
      - nrf52840dk_nrf52840
      - decawave_dwm1001_dev
      - qorvo_dwm3001c_dev
    extra_args: OVERLAY_CONFIG=overlay-ot-rnb.conf
    build_only: true
    tags: ci_build
```

## prj.conf
```kconfig
#
# Copyright (c) 2020 Nordic Semiconductor
#
# SPDX-License-Identifier: LicenseRef-Nordic-5-Clause
#

# nRF board library
CONFIG_DK_LIBRARY=y

# Enable CoAP utils and CoAP protocol
CONFIG_COAP_UTILS=y

# Configure sample logging setting
CONFIG_COAP_CLIENT_LOG_LEVEL_DBG=y
CONFIG_COAP_CLIENT_UTILS_LOG_LEVEL_DBG=y
CONFIG_COAP_UTILS_LOG_LEVEL_DBG=y

# Generic networking options
CONFIG_NETWORKING=y

# L2 OpenThread enabling
CONFIG_NET_L2_OPENTHREAD=y

# Network shell
CONFIG_SHELL=y
CONFIG_OPENTHREAD_SHELL=y
CONFIG_SHELL_ARGC_MAX=26
CONFIG_SHELL_CMD_BUFF_SIZE=416

# Network sockets
CONFIG_NET_SOCKETS=y
CONFIG_NET_SOCKETS_POSIX_NAMES=y
CONFIG_NET_SOCKETS_POLL_MAX=4

CONFIG_NET_L2_OPENTHREAD=y

# Generic networking options
CONFIG_NETWORKING=y

CONFIG_OPENTHREAD_L2_LOG_LEVEL_INF=y
CONFIG_ASSERT=y
CONFIG_ASSERT_NO_COND_INFO=y
CONFIG_ASSERT_NO_MSG_INFO=y
CONFIG_MBEDTLS_SHA1_C=n
CONFIG_FPU=y
CONFIG_OPENTHREAD_DEBUG=y
CONFIG_OPENTHREAD_L2_DEBUG=y
```

## overlay-ot-rnb.conf
```kconfig
#
# Copyright (c) 2022 RedNodeLabs
#

CONFIG_NEWLIB_LIBC=y

# Disable TCP and IPv4 (TCP disabled to avoid heavy traffic)
CONFIG_NET_TCP=n
CONFIG_NET_IPV4=n

CONFIG_NET_IPV6_NBR_CACHE=n
CONFIG_NET_IPV6_MLD=n
CONFIG_NET_CONFIG_NEED_IPV4=n
CONFIG_NET_CONFIG_MY_IPV4_ADDR=""
CONFIG_NET_CONFIG_PEER_IPV4_ADDR=""

CONFIG_SYSTEM_WORKQUEUE_STACK_SIZE=2048
CONFIG_SYSTEM_WORKQUEUE_PRIORITY=1
CONFIG_MAIN_STACK_SIZE=2048

CONFIG_NET_L2_OPENTHREAD=y

CONFIG_OPENTHREAD_DEBUG=y
CONFIG_OPENTHREAD_L2_DEBUG=y
CONFIG_OPENTHREAD_L2_LOG_LEVEL_INF=y

CONFIG_SHELL=n
CONFIG_NET_SHELL=n
CONFIG_NET_MGMT=n
CONFIG_NET_STATISTICS=n
CONFIG_CONSOLE=n
CONFIG_SERIAL=n
CONFIG_USE_SEGGER_RTT=n
CONFIG_FLASH_SHELL=n
CONFIG_OPENTHREAD_MTD=y
CONFIG_OPENTHREAD_SLAAC=y

# Network buffers
CONFIG_OPENTHREAD_NUM_MESSAGE_BUFFERS=32
CONFIG_NET_PKT_RX_COUNT=4
CONFIG_NET_PKT_TX_COUNT=4
CONFIG_NET_BUF_RX_COUNT=16
CONFIG_NET_BUF_TX_COUNT=16
```

## overlay-rednodebus-debug.conf
```kconfig
# For Low Power Measurements disable both SERIAL and RTT
CONFIG_SERIAL=n
CONFIG_USE_SEGGER_RTT=y

CONFIG_LOG_PRINTK=y
CONFIG_LOG_BACKEND_RTT=y
CONFIG_LOG_BACKEND_UART=n

CONFIG_SHELL_BACKEND_RTT=n
CONFIG_SHELL_BACKEND_SERIAL=y
```

## overlay-rednodebus-ot.conf
```kconfig
CONFIG_NEWLIB_LIBC=y

# Disable TCP and IPv4 (TCP disabled to avoid heavy traffic)
CONFIG_NET_TCP=n
CONFIG_NET_IPV4=n

CONFIG_NET_IPV6_NBR_CACHE=n
CONFIG_NET_IPV6_MLD=n
CONFIG_NET_CONFIG_NEED_IPV4=n
CONFIG_NET_CONFIG_MY_IPV4_ADDR=""
CONFIG_NET_CONFIG_PEER_IPV4_ADDR=""

CONFIG_SYSTEM_WORKQUEUE_STACK_SIZE=1536

# RedNodeBus specific
CONFIG_REDNODEBUS=y

CONFIG_REDNODEBUS_COMMISSIONING=n
CONFIG_REDNODEBUS_ROLE=2
CONFIG_REDNODEBUS_NODE_ID=0

CONFIG_TEST_RANDOM_GENERATOR=n
# >> OT
CONFIG_REDNODEBUS_EMPTY_PAYLOAD=n
CONFIG_REDNODEBUS_REDNODERANGING_DIAGNOSTIC_ENABLED=n
# <<
CONFIG_REDNODEBUS_DRIVER_LOG_LEVEL_INF=y

#######################
CONFIG_FLASH_SHELL=n
CONFIG_NET_SHELL=n
CONFIG_NET_LOG=n
CONFIG_SERIAL=n

#CONFIG_REDNODEBUS_NRF5_RX_STACK_SIZE=800
#CONFIG_REDNODEBUS_NRF5_REDNODEBUS_EVENT_STACK_SIZE=800
#CONFIG_NRF_REDNODEBUS_EVENT_BUFFERS=6
#CONFIG_NRF_REDNODEBUS_RX_BUFFERS=8

#CONFIG_MAIN_STACK_SIZE=2048
#CONFIG_PRIVILEGED_STACK_SIZE=1024

#CONFIG_SYSTEM_WORKQUEUE_STACK_SIZE=2048
#CONFIG_MBEDTLS_HEAP_SIZE=10240
#CONFIG_OPENTHREAD_THREAD_STACK_SIZE=6240
#CONFIG_OPENTHREAD_RADIO_WORKQUEUE_STACK_SIZE=736

#CONFIG_MBEDTLS_SSL_MAX_CONTENT_LEN=768

#CONFIG_IDLE_STACK_SIZE=320
#CONFIG_ISR_STACK_SIZE=2048

CONFIG_CONSOLE=n

CONFIG_OPENTHREAD_NUM_MESSAGE_BUFFERS=8

CONFIG_NET_PKT_RX_COUNT=10
CONFIG_NET_PKT_TX_COUNT=16
CONFIG_NET_BUF_RX_COUNT=16
CONFIG_NET_BUF_TX_COUNT=16

#CONFIG_NET_TX_STACK_SIZE=1200
#CONFIG_NET_RX_STACK_SIZE=1500

#CONFIG_NET_MGMT=n
CONFIG_NET_STATISTICS=n

#######################

# Enable OpenThread shell
CONFIG_SHELL=y
CONFIG_OPENTHREAD_SHELL=y
CONFIG_SHELL_STACK_SIZE=3072

CONFIG_NET_L2_OPENTHREAD=y

CONFIG_OPENTHREAD_DEBUG=y
CONFIG_OPENTHREAD_LOG_LEVEL_WARN=y
#CONFIG_OPENTHREAD_L2_DEBUG=y
#CONFIG_OPENTHREAD_L2_LOG_LEVEL_INF=y

CONFIG_OPENTHREAD_PANID=4660
CONFIG_OPENTHREAD_CHANNEL=26
CONFIG_OPENTHREAD_NETWORK_NAME="OpenThreadDemo"
CONFIG_OPENTHREAD_XPANID="1111111122222222"
CONFIG_OPENTHREAD_NETWORKKEY="00:11:22:33:44:55:66:77:88:99:aa:bb:cc:dd:ee:ff"

#CONFIG_NET_CONFIG_MY_IPV6_ADDR="fdde:ad00:beef::1"
#CONFIG_NET_CONFIG_PEER_IPV6_ADDR="fdde:ad00:beef::2"

# mbedTLS tweaks
CONFIG_MBEDTLS_SSL_MAX_CONTENT_LEN=768

# A sample configuration to enable Thread Joiner, uncomment if needed
#CONFIG_OPENTHREAD_JOINER=y
#CONFIG_OPENTHREAD_JOINER_AUTOSTART=y

# Enable diagnostic module, uncomment if needed
#CONFIG_OPENTHREAD_DIAG=y

CONFIG_OPENTHREAD_MTD=y
CONFIG_OPENTHREAD_PING_SENDER=y
CONFIG_OPENTHREAD_SLAAC=y
CONFIG_OPENTHREAD_DNS_CLIENT=y
CONFIG_NET_IF_UNICAST_IPV6_ADDR_COUNT=6

# RedNodeRanging specific
CONFIG_REDNODERANGING=y
CONFIG_REDNODERANGING_DRIVER_LOG_LEVEL_INF=y

CONFIG_SPI_BLOCKING=y
```

## boards/nrf52840dk_nrf52840.overlay
```dts
/* Copyright (c) 2020 Nordic Semiconductor ASA
 *
 * SPDX-License-Identifier: LicenseRef-Nordic-5-Clause
 */

/ {
	/*
	* In some default configurations within the nRF Connect SDK,
	* e.g. on nRF52840, the chosen zephyr,entropy node is &cryptocell.
	* This devicetree overlay ensures that default is overridden wherever it
	* is set, as this application uses the RNG node for entropy exclusively.
	*/
	chosen {
		zephyr,entropy = &rng;
	};

	aliases {
		rnb-tx-led = &led0;
		rnb-rx-led = &led1;
	};
};
```

## boards/nrf52840dongle_nrf52840.overlay
```dts
/* Copyright (c) 2022 RedNodeLabs.
 *
 */

/ {
	aliases {
		rnb-tx-led = &led1_red;
		rnb-rx-led = &led0_green;
	};
};
```

## src/coap_client.c
```c
/*
 * Copyright (c) 2020 Nordic Semiconductor ASA
 *
 * SPDX-License-Identifier: LicenseRef-Nordic-5-Clause
 */

#include <zephyr.h>
#include <dk_buttons_and_leds.h>
#include <logging/log.h>
#include <ram_pwrdn.h>
#include <device.h>

#include "coap_client_utils.h"

#if CONFIG_BT_NUS
#include "ble_utils.h"
#endif

#ifdef CONFIG_REDNODEBUS
#include "rnb_utils.h"
#endif /* CONFIG_REDNODEBUS */

#ifdef CONFIG_BOOTLOADER_MCUBOOT
#include <dfu/mcuboot.h>
#endif

LOG_MODULE_REGISTER(coap_client, CONFIG_COAP_CLIENT_LOG_LEVEL);

#define CONSOLE_LABEL DT_LABEL(DT_CHOSEN(zephyr_console))

#define OT_CONNECTION_LED DK_LED1
#define BLE_CONNECTION_LED DK_LED2
#define MTD_SED_LED DK_LED3

#if CONFIG_BT_NUS

#define COMMAND_REQUEST_UNICAST 'u'
#define COMMAND_REQUEST_MULTICAST 'm'
#define COMMAND_REQUEST_PROVISIONING 'p'

static void on_nus_received(struct bt_conn *conn, const uint8_t *const data,
			    uint16_t len)
{
	if (len != 1) {
		LOG_WRN("Received invalid data length (%hd) from NUS", len);
		return;
	}

	LOG_INF("Received data: %c", data[0]);

	switch (*data) {
	case COMMAND_REQUEST_UNICAST:
		coap_client_toggle_one_light();
		break;

	case COMMAND_REQUEST_MULTICAST:
		coap_client_toggle_mesh_lights();
		break;

	case COMMAND_REQUEST_PROVISIONING:
		coap_client_send_provisioning_request();
		break;

	default:
		LOG_WRN("Received invalid data from NUS");
	}
}

static void on_ble_connect(struct k_work *item)
{
	ARG_UNUSED(item);

	//dk_set_led_on(BLE_CONNECTION_LED);
}

static void on_ble_disconnect(struct k_work *item)
{
	ARG_UNUSED(item);

	//dk_set_led_off(BLE_CONNECTION_LED);
}

#endif /* CONFIG_BT_NUS */

static void on_ot_connect(struct k_work *item)
{
	ARG_UNUSED(item);

	//dk_set_led_on(OT_CONNECTION_LED);
}

static void on_ot_disconnect(struct k_work *item)
{
	ARG_UNUSED(item);

	//dk_set_led_off(OT_CONNECTION_LED);
}

static void on_mtd_mode_toggle(uint32_t med)
{
/*
#if IS_ENABLED(CONFIG_PM_DEVICE)
	const struct device *cons = device_get_binding(CONSOLE_LABEL);

	if (med) {
		pm_device_state_set(cons, PM_DEVICE_STATE_ACTIVE);
	} else {
		pm_device_state_set(cons, PM_DEVICE_STATE_SUSPENDED);
	}
#endif
	dk_set_led(MTD_SED_LED, med);
*/
}

static void on_button_changed(uint32_t button_state, uint32_t has_changed)
{
	uint32_t buttons = button_state & has_changed;

	if (buttons & DK_BTN1_MSK) {
		coap_client_toggle_one_light();
	}

	if (buttons & DK_BTN2_MSK) {
		coap_client_toggle_mesh_lights();
	}

	if (buttons & DK_BTN3_MSK) {
		coap_client_toggle_minimal_sleepy_end_device();
	}

	if (buttons & DK_BTN4_MSK) {
		coap_client_send_provisioning_request();
	}
}

void main(void)
{
	int ret;

	LOG_INF("Start CoAP-client sample");

	if (IS_ENABLED(CONFIG_RAM_POWER_DOWN_LIBRARY)) {
		power_down_unused_ram();
	}

#ifdef CONFIG_BOOTLOADER_MCUBOOT
	/* Check if the image is run in the REVERT mode and eventually
	 * confirm it to prevent reverting on the next boot.
	 */
	if (mcuboot_swap_type() == BOOT_SWAP_TYPE_REVERT) {
		if (boot_write_img_confirmed()) {
			LOG_ERR("Confirming firmware image failed, it will be reverted on the next "
				"boot.");
		} else {
			LOG_INF("New device firmware image confirmed.");
		}
	}
#endif

	ret = dk_buttons_init(on_button_changed);
	if (ret) {
		LOG_ERR("Cannot init buttons (error: %d)", ret);
		return;
	}

//	ret = dk_leds_init();
//	if (ret) {
//		LOG_ERR("Cannot init leds, (error: %d)", ret);
//		return;
//	}

#ifdef CONFIG_REDNODEBUS
    init_rnb();
#endif /* CONFIG_REDNODEBUS */

#if CONFIG_BT_NUS
	struct bt_nus_cb nus_clbs = {
		.received = on_nus_received,
		.sent = NULL,
	};

	ret = ble_utils_init(&nus_clbs, on_ble_connect, on_ble_disconnect);
	if (ret) {
		LOG_ERR("Cannot init BLE utilities");
		return;
	}

#endif /* CONFIG_BT_NUS */

	coap_client_utils_init(on_ot_connect, on_ot_disconnect,
			       on_mtd_mode_toggle);
}
```

## src/coap_client_utils.c
```c
/*
 * Copyright (c) 2020 Nordic Semiconductor ASA
 *
 * SPDX-License-Identifier: LicenseRef-Nordic-5-Clause
 */

#include <zephyr.h>
#include <coap_server_client_interface.h>
#include <net/coap_utils.h>
#include <logging/log.h>
#include <net/openthread.h>
#include <net/socket.h>
#include <openthread/thread.h>

#include "coap_client_utils.h"

LOG_MODULE_REGISTER(coap_client_utils, CONFIG_COAP_CLIENT_UTILS_LOG_LEVEL);

#define RESPONSE_POLL_PERIOD 100
#define HARDCODED_UNICAST_IP 1

static uint32_t poll_period;

static bool is_connected;

static struct k_work unicast_light_work;
static struct k_work multicast_light_work;
static struct k_work toggle_MTD_SED_work;
static struct k_work provisioning_work;
static struct k_work on_connect_work;
static struct k_work on_disconnect_work;

mtd_mode_toggle_cb_t on_mtd_mode_toggle;

/* Options supported by the server */
static const char *const light_option[] = { LIGHT_URI_PATH, NULL };
static const char *const provisioning_option[] = { PROVISIONING_URI_PATH,
						   NULL };

/* Thread multicast mesh local address */
static struct sockaddr_in6 multicast_local_addr = {
	.sin6_family = AF_INET6,
	.sin6_port = htons(COAP_PORT),
	.sin6_addr.s6_addr = { 0xff, 0x03, 0x00, 0x00, 0x00, 0x00, 0x00, 0x00,
			       0x00, 0x00, 0x00, 0x00, 0x00, 0x00, 0x00, 0x01 },
	.sin6_scope_id = 0U
};

/* Variable for storing server address acquiring in provisioning handshake */
static char unique_local_addr_str[INET6_ADDRSTRLEN];

#if HARDCODED_UNICAST_IP
static struct sockaddr_in6 unique_local_addr = {
        .sin6_family = AF_INET6,
        .sin6_port = htons(COAP_PORT),
        .sin6_addr.s6_addr = { 0x20, 0x01, 0x0d, 0xb8, 0x00, 0x01, 0xff, 0xff,
                0x00, 0x00, 0x00, 0x00, 0xac, 0x11, 0x00, 0x01 },
        .sin6_scope_id = 0U
};
#elif
static struct sockaddr_in6 unique_local_addr = {
	.sin6_family = AF_INET6,
	.sin6_port = htons(COAP_PORT),
	.sin6_addr.s6_addr = {0, },
	.sin6_scope_id = 0U
};
#endif

static bool is_mtd_in_med_mode(otInstance *instance)
{
	return otThreadGetLinkMode(instance).mRxOnWhenIdle;
}

static void poll_period_response_set(void)
{
	otError error;

	otInstance *instance = openthread_get_default_instance();

	if (is_mtd_in_med_mode(instance)) {
		return;
	}

	if (!poll_period) {
		poll_period = otLinkGetPollPeriod(instance);

		error = otLinkSetPollPeriod(instance, RESPONSE_POLL_PERIOD);
		__ASSERT(error == OT_ERROR_NONE, "Failed to set pool period");

		LOG_INF("Poll Period: %dms set", RESPONSE_POLL_PERIOD);
	}
}

static void poll_period_restore(void)
{
	otError error;
	otInstance *instance = openthread_get_default_instance();

	if (is_mtd_in_med_mode(instance)) {
		return;
	}

	if (poll_period) {
		error = otLinkSetPollPeriod(instance, poll_period);
		__ASSERT_NO_MSG(error == OT_ERROR_NONE);

		LOG_INF("Poll Period: %dms restored", poll_period);
		poll_period = 0;
	}
}

static int on_provisioning_reply(const struct coap_packet *response,
				 struct coap_reply *reply,
				 const struct sockaddr *from)
{
	int ret = 0;
	const uint8_t *payload;
	uint16_t payload_size = 0u;

	ARG_UNUSED(reply);
	ARG_UNUSED(from);

	payload = coap_packet_get_payload(response, &payload_size);

	if (payload == NULL ||
	    payload_size != sizeof(unique_local_addr.sin6_addr)) {
		LOG_ERR("Received data is invalid");
		ret = -EINVAL;
		goto exit;
	}

	memcpy(&unique_local_addr.sin6_addr, payload, payload_size);

	if (!inet_ntop(AF_INET6, payload, unique_local_addr_str,
		       INET6_ADDRSTRLEN)) {
		LOG_ERR("Received data is not IPv6 address: %d", errno);
		ret = -errno;
		goto exit;
	}

	LOG_INF("Received peer address: %s", unique_local_addr_str);

exit:
	if (IS_ENABLED(CONFIG_OPENTHREAD_MTD_SED)) {
		poll_period_restore();
	}

	return ret;
}

static void toggle_one_light(struct k_work *item)
{
	uint8_t payload = (uint8_t)THREAD_COAP_UTILS_LIGHT_CMD_TOGGLE;

	ARG_UNUSED(item);

	if (unique_local_addr.sin6_addr.s6_addr16[0] == 0) {
		LOG_WRN("Peer address not set. Activate 'provisioning' option "
			"on the server side");
		return;
	}

#if HARDCODED_UNICAST_IP
	if (!inet_ntop(AF_INET6, &unique_local_addr.sin6_addr.s6_addr16[0],
	               unique_local_addr_str,
	               INET6_ADDRSTRLEN)) {
	        LOG_ERR("Hardcoded IP is not valid IPv6 address: %d", errno);
	        return;
	}
#endif

	LOG_INF("Send 'light' request to: %s", unique_local_addr_str);
	coap_send_request(COAP_METHOD_PUT,
			  (const struct sockaddr *)&unique_local_addr,
			  light_option, &payload, sizeof(payload), NULL);
}

static void toggle_mesh_lights(struct k_work *item)
{
	static uint8_t command = (uint8_t)THREAD_COAP_UTILS_LIGHT_CMD_OFF;

	ARG_UNUSED(item);

	command = ((command == THREAD_COAP_UTILS_LIGHT_CMD_OFF) ?
			   THREAD_COAP_UTILS_LIGHT_CMD_ON :
			   THREAD_COAP_UTILS_LIGHT_CMD_OFF);

	LOG_INF("Send multicast mesh 'light' request");
	coap_send_request(COAP_METHOD_PUT,
			  (const struct sockaddr *)&multicast_local_addr,
			  light_option, &command, sizeof(command), NULL);
}

static void send_provisioning_request(struct k_work *item)
{
	ARG_UNUSED(item);

	if (IS_ENABLED(CONFIG_OPENTHREAD_MTD_SED)) {
		/* decrease the polling period for higher responsiveness */
		poll_period_response_set();
	}

	LOG_INF("Send 'provisioning' request");
	coap_send_request(COAP_METHOD_GET,
			  (const struct sockaddr *)&multicast_local_addr,
			  provisioning_option, NULL, 0u, on_provisioning_reply);
}

static void toggle_minimal_sleepy_end_device(struct k_work *item)
{
	otError error;
	otLinkModeConfig mode;
	struct openthread_context *context = openthread_get_default_context();

	__ASSERT_NO_MSG(context != NULL);

	openthread_api_mutex_lock(context);
	mode = otThreadGetLinkMode(context->instance);
	mode.mRxOnWhenIdle = !mode.mRxOnWhenIdle;
	error = otThreadSetLinkMode(context->instance, mode);
	openthread_api_mutex_unlock(context);

	if (error != OT_ERROR_NONE) {
		LOG_ERR("Failed to set MLE link mode configuration");
	} else {
		on_mtd_mode_toggle(mode.mRxOnWhenIdle);
	}
}

static void update_device_state(void)
{
	struct otInstance *instance = openthread_get_default_instance();
	otLinkModeConfig mode = otThreadGetLinkMode(instance);
	on_mtd_mode_toggle(mode.mRxOnWhenIdle);
}

static void on_thread_state_changed(uint32_t flags, void *context)
{
	struct openthread_context *ot_context = context;

	if (flags & OT_CHANGED_THREAD_ROLE) {
		switch (otThreadGetDeviceRole(ot_context->instance)) {
		case OT_DEVICE_ROLE_CHILD:
		case OT_DEVICE_ROLE_ROUTER:
		case OT_DEVICE_ROLE_LEADER:
			k_work_submit(&on_connect_work);
			is_connected = true;
			break;

		case OT_DEVICE_ROLE_DISABLED:
		case OT_DEVICE_ROLE_DETACHED:
		default:
			k_work_submit(&on_disconnect_work);
			is_connected = false;
			break;
		}
	}
}

static void submit_work_if_connected(struct k_work *work)
{
	if (is_connected) {
		k_work_submit(work);
	} else {
		LOG_INF("Connection is broken");
	}
}

void coap_client_utils_init(ot_connection_cb_t on_connect,
			    ot_disconnection_cb_t on_disconnect,
			    mtd_mode_toggle_cb_t on_toggle)
{
	on_mtd_mode_toggle = on_toggle;

	coap_init(AF_INET6, NULL);

	k_work_init(&on_connect_work, on_connect);
	k_work_init(&on_disconnect_work, on_disconnect);
	k_work_init(&unicast_light_work, toggle_one_light);
	k_work_init(&multicast_light_work, toggle_mesh_lights);
	k_work_init(&provisioning_work, send_provisioning_request);

	openthread_set_state_changed_cb(on_thread_state_changed);
	// openthread_start(openthread_get_default_context()); // Managed by RedNodeBus

	if (IS_ENABLED(CONFIG_OPENTHREAD_MTD_SED)) {
		k_work_init(&toggle_MTD_SED_work,
			    toggle_minimal_sleepy_end_device);
		update_device_state();
	}
}

void coap_client_toggle_one_light(void)
{
	submit_work_if_connected(&unicast_light_work);
}

void coap_client_toggle_mesh_lights(void)
{
	submit_work_if_connected(&multicast_light_work);
}

void coap_client_send_provisioning_request(void)
{
	submit_work_if_connected(&provisioning_work);
}

void coap_client_toggle_minimal_sleepy_end_device(void)
{
	if (IS_ENABLED(CONFIG_OPENTHREAD_MTD_SED)) {
		k_work_submit(&toggle_MTD_SED_work);
	}
}
```

## src/rnb_utils.c
```c
/* rnb.c - RedNodeBus specific code for node */

/*
 * Copyright (c) 2022 RedNodeLabs.
 *
 * SPDX-License-Identifier: Apache-2.0
 */

#include <logging/log.h>

#include <zephyr.h>
#include <errno.h>
#include <stdio.h>

#include <net/ieee802154_radio.h>
#include <net/openthread.h>

/* Convenience defines for RADIO */
#define REDNODEBUS_API(dev) \
	((const struct ieee802154_radio_api *const)(dev)->api)

static bool is_rnb_configured;
static struct rednodebus_user_config rnb_user_config;
static struct rednodebus_user_ranging_config rnb_user_ranging_config;

void print_rnb_state(const uint8_t state)
{
	switch (state)
	{
	case REDNODEBUS_USER_BUS_STATE_CONNECTED:
		LOG_INF("RNB state: CONNECTED");
		break;
	case REDNODEBUS_USER_BUS_STATE_SYNCHRONIZED:
		LOG_INF("RNB state: SYNCHRONIZED");
		break;
	case REDNODEBUS_USER_BUS_STATE_UNSYNCHRONIZED:
		LOG_INF("RNB state: UNSYNCHRONIZED");
		break;
	case REDNODEBUS_USER_BUS_STATE_STOPPED:
		LOG_INF("RNB state: STOPPED");
		break;
	default:
		LOG_WRN("RNB state: unknown");
		break;
	}
}

void print_rnb_role(const uint8_t role)
{
	switch (role)
	{
	case REDNODEBUS_USER_ROLE_TAG:
		LOG_INF("RNB role: TAG");
		break;
	case REDNODEBUS_USER_ROLE_ANCHOR:
		LOG_INF("RNB role: ANCHOR");
		break;
	case REDNODEBUS_USER_ROLE_UNDEFINED:
		LOG_INF("RNB role: UNDEFINED");
		break;
	default:
		LOG_WRN("RNB role: unknown");
		break;
	}
}

void print_rnb_uwb_mode(const uint8_t uwb_mode)
{
	switch (uwb_mode)
	{
	case REDNODEBUS_USER_UWB_MODE_HIGH_RATE_CTXP:
		LOG_INF("RNB UWB mode: HIGH_RATE_CTXP");
		break;
	case REDNODEBUS_USER_UWB_MODE_LONG_RANGE_CTXP:
		LOG_INF("RNB UWB mode: LONG_RANGE_CTXP");
		break;
	case REDNODEBUS_USER_UWB_MODE_HIGH_RATE_STXP:
		LOG_INF("RNB UWB mode: HIGH_RATE_STXP");
		break;
	case REDNODEBUS_USER_UWB_MODE_LONG_RANGE_STXP:
		LOG_INF("RNB UWB mode: LONG_RANGE_STXP");
		break;
	case REDNODEBUS_USER_UWB_MODE_NONE:
		LOG_INF("RNB UWB mode: MODE_NONE");
		break;
	default:
		LOG_WRN("RNB UWB mode: unknown");
		break;
	}
}

void print_rnb_ranging_mode(const uint8_t ranging_mode)
{
	switch (ranging_mode)
	{
	case REDNODEBUS_USER_RANGING_MODE_2W_T2A:
		LOG_INF("RNB ranging mode: 2W_T2A");
		break;
	case REDNODEBUS_USER_RANGING_MODE_2W_A2T:
		LOG_INF("RNB ranging mode: 2W_A2T");
		break;
	case REDNODEBUS_USER_RANGING_MODE_3W_A2T:
		LOG_INF("RNB ranging mode: HIGH_RATE_STXP");
		break;
	case REDNODEBUS_USER_RANGING_MODE_3W_A2A:
		LOG_INF("RNB ranging mode: 3W_A2T");
		break;
	case REDNODEBUS_USER_RANGING_MODE_DISABLED:
		LOG_INF("RNB ranging mode: DISABLED");
		break;
	default:
		LOG_WRN("RNB ranging mode: unknown");
		break;
	}
}

void handle_radio_rnb_user_event(const struct device *dev,
								 enum rednodebus_user_event evt,
								 void *event_params)
{
	ARG_UNUSED(dev);

	const struct rednodebus_user_event_params *rnb_user_event_params =
		(const struct rednodebus_user_event_params *)event_params;

	switch (evt)
	{
	case REDNODEBUS_USER_EVENT_NEW_STATE:
		LOG_DBG("RNB user event new state");

		print_rnb_state(rnb_user_event_params->state);

		if (rnb_user_event_params->state > REDNODEBUS_USER_BUS_STATE_UNSYNCHRONIZED)
		{
			if (rnb_user_event_params->role != REDNODEBUS_USER_ROLE_UNDEFINED)
			{
				print_rnb_role(rnb_user_event_params->role);
			}

			LOG_INF("RNB period ms %u", rnb_user_event_params->period_ms);
		}
		else if (rnb_user_event_params->state == REDNODEBUS_USER_BUS_STATE_STOPPED)
		{
			if (!is_rnb_configured)
			{
				REDNODEBUS_API(dev)->configure_rnb(dev, &rnb_user_config);

				REDNODEBUS_API(dev)->configure_rnb_ranging(dev, &rnb_user_ranging_config);

				is_rnb_configured = true;

				openthread_start(openthread_get_default_context());
			}
		}

		if (rnb_user_event_params->ranging_mode != REDNODEBUS_USER_RANGING_MODE_DISABLED)
		{
			print_rnb_uwb_mode(rnb_user_event_params->uwb_mode);
			print_rnb_ranging_mode(rnb_user_event_params->ranging_mode);
		}
		break;
	default:
		LOG_WRN("RNB user event: unknown");
		break;
	}
}

int init_rnb(void)
{
	is_rnb_configured = false;

	const struct device *dev = device_get_binding(CONFIG_IEEE802154_NRF5_DRV_NAME);
	struct ieee802154_config ieee802154_config;

	ieee802154_config.rnb_user_event_handler = handle_radio_rnb_user_event;
	REDNODEBUS_API(dev)->configure(dev, REDNODEBUS_CONFIG_USER_EVENT_HANDLER, &ieee802154_config);

	rnb_user_config.network_id = 0;
	rnb_user_config.role = REDNODEBUS_USER_ROLE_UNDEFINED;
	rnb_user_config.sync_active_period_ms = 2000;
	rnb_user_config.sync_sleep_period_ms = 10000;

	rnb_user_ranging_config.ranging_enabled = true;
	rnb_user_ranging_config.ranging_period_ms = 0;

	return 0;
}
```
